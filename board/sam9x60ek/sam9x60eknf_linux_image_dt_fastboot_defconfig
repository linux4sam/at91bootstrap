## board/sam9x60ek/sam9x60eknf_linux_image_dt_fastboot_defconfig
```kconfig
CONFIG_SAM9X60EK=y
CONFIG_RAM_256MB=y
CONFIG_NANDFLASH=y
# CONFIG_PMECC_AUTO_DETECT is not set
CONFIG_PMECC_CORRECT_BITS_8=y
# CONFIG_USE_ON_DIE_ECC_SUPPORT is not set
CONFIG_LOAD_LINUX=y
CONFIG_OVERRIDE_CMDLINE=y
CONFIG_LINUX_KERNEL_ARG_STRING="mem=256M console=ttyS0,115200 root=/dev/mmcblk0p2 rw rootwait rootfstype=ext4 atmel.pm_modes=standby,ulp0 quiet"
CONFIG_THUMB=y
CONFIG_SCLK_INTRC=y
# CONFIG_LOAD_EEPROM is not set
CONFIG_LOGO=y
CONFIG_LOGO_SCALE="4"
```

## board/sam9x60ek/sam9x60eksd_linux_image_dt_fastboot_defconfig
```kconfig
CONFIG_SAM9X60EK=y
CONFIG_RAM_256MB=y
CONFIG_SDCARD=y
CONFIG_LOAD_LINUX=y
CONFIG_OVERRIDE_CMDLINE=y
CONFIG_LINUX_KERNEL_ARG_STRING="mem=256M console=ttyS0,115200 root=/dev/mmcblk0p2 rw rootwait rootfstype=ext4 atmel.pm_modes=standby,ulp0 quiet"
CONFIG_OF_OVERRIDE_DTB_NAME="at91-sam9x60ek.dtb"
CONFIG_IMAGE_NAME="zImage"
CONFIG_THUMB=y
CONFIG_SCLK_INTRC=y
# CONFIG_LOAD_EEPROM is not set
CONFIG_LOGO=y
CONFIG_LOGO_SCALE="4"
```

## board/sama5d27_som1_ek/sama5d27_som1_bkptnone_defconfig
```kconfig
CONFIG_SAMA5D27_SOM1_EK=y
CONFIG_RAM_128MB=y
CONFIG_QSPI=y
CONFIG_LOAD_NONE=y
CONFIG_BKPT_NOTIFY_DONE=y
CONFIG_DEBUG=y
# CONFIG_ENTER_NWD is not set
```

## board/sama5d27_wlsom1_ek/sama5d27_wlsom1_eksd_uboot_defconfig
```kconfig
CONFIG_SAMA5D27_WLSOM1_EK=y
CONFIG_RAM_256MB=y
CONFIG_LPDDR2=y
CONFIG_DEBUG=y
# CONFIG_ENTER_NWD is not set
```

## board/sama5d2_lpddr2sip_vb/sama5d2_lpddr2sip_vb_bkptnone_defconfig
```kconfig
CONFIG_SAMA5D2_LPDDR2SIP_VB=y
CONFIG_RAM_256MB=y
CONFIG_LPDDR2=y
CONFIG_LOAD_NONE=y
CONFIG_BKPT_NOTIFY_DONE=y
CONFIG_DEBUG=y
# CONFIG_ENTER_NWD is not set
```

## board/sama5d2_ptc_ek/sama5d2_ptc_ek_bkptnone_defconfig
```kconfig
CONFIG_SAMA5D2_PTC_EK=y
CONFIG_RAM_512MB=y
CONFIG_DDR2=y
CONFIG_LOAD_NONE=y
CONFIG_BKPT_NOTIFY_DONE=y
CONFIG_DEBUG=y
# CONFIG_ENTER_NWD is not set
```

## board/sama5d2_xplained/sama5d2_xplaineddf_uboot_defconfig
```kconfig
CONFIG_SAMA5D2_XPLAINED=y
CONFIG_BUS_SPEED_166MHZ=y
CONFIG_RAM_512MB=y
CONFIG_DDR3=y
CONFIG_DEBUG=y
# CONFIG_ENTER_NWD is not set
```

## board/sama5d31_beeave/sama5d31_beeave_rel_defconfig
```kconfig
CONFIG_SAMA5D31_BEEAVE=y
CONFIG_BOARDNAME="sama5d31_beeave"
CONFIG_MACH_TYPE="9999"
CONFIG_LINK_ADDR="0x000000"
CONFIG_TOP_OF_MEMORY="0x310000"
CONFIG_CRYSTAL_12_000MHZ=y
CONFIG_CRYSTAL="CRYSTAL_12_000MHZ"
CONFIG_CPU_CLK_498MHZ=y
CONFIG_BUS_SPEED_166MHZ=y
# CONFIG_CPU_V7 is not set

#
# Memory selection
#
ALLOW_DATAFLASH=y
ALLOW_WITH_MMU=y
ALLOW_WITH_CACHE=y
ALLOW_WITH_DMA=y
ALLOW_KNOWN_RAM_CHIP_DEFINITION=y

CONFIG_DDRC=y
CONFIG_LPDDR1=y
CONFIG_RAM_CHIP_W948D2=y
CONFIG_RAM_32MB=y

#
# NAND/Flash selection
#
CONFIG_DATAFLASH=y
CONFIG_MEMORY="dataflash"

#
# SPI configuration
#
CONFIG_SPI_CLK=40000000
CONFIG_SMALL_DATAFLASH=y
# ALLOW_DATAFLASH_RECOVERY is not set
# CONFIG_DATAFLASH_LOAD_WITH_DMA is not set
ALLOW_BOOT_FROM_DATAFLASH_CS0=y
CONFIG_SPI_BOOT_CS0=y
CONFIG_CARD_SUFFIX=""
CONFIG_SPI_BOOT="AT91C_SPI_PCS0_DATAFLASH"

#
# SPI Flash
#
CONFIG_SET_PARAMS_SPI_FLASH=y

#
# Configured SPI FLash Parameters
#
CONFIG_SPI_FLASH_PARAMS_PAGES=8192
CONFIG_SPI_FLASH_PARAMS_PAGE_SIZE_IS_POWER2=y
CONFIG_BOOTSTRAP_MAXSIZE="65536"
CONFIG_PROJECT="dataflash"
CONFIG_BUILD_RELEASE=y
CONFIG_LOAD_1MB=y
CONFIG_IMG_ADDRESS="0x10000"
CONFIG_JUMP_ADDR="0x20000000"
CONFIG_IMG_SIZE="0x00100000"

#
# Application checked load support
#
CONFIG_CHECK_APPLICATION_LOAD=y
CONFIG_CHECK_APPLICATION_VALUE=0xECDEB1EF
CONFIG_CHECK_APPLICATION_VAL_ADDR_OFFSET=4

#
# LED debugging ...
#
CONFIG_BEEAVE_WITH_DEBUG_LEDS=y
# CONFIG_BEEAVE_DEBUG_LEDS_OFF is not set
CONFIG_BEEAVE_DEBUG_LEDS_ON=y
CONFIG_DISABLE_WATCHDOG=y
#
# Hardware Initialization Options
#
CONFIG_HW_INIT=y
CONFIG_USER_HW_INIT=y
```

## board/sama5d3_xplained/sama5d3_xplainednf_linux_uimage_dt_defconfig
```kconfig
CONFIG_SAMA5D3_XPLAINED=y
CONFIG_CPU_CLK_528MHZ=y
CONFIG_RAM_512MB=y
# CONFIG_PMECC_AUTO_DETECT is not set
CONFIG_PMECC_CORRECT_BITS_4=y
CONFIG_LOAD_LINUX=y
CONFIG_MEM_SIZE="0x10000000"
CONFIG_DEBUG=y
CONFIG_SCLK=y
CONFIG_PM_EXTERNAL_DEVICES=y
CONFIG_ACT8865=y
```

## board/sama5d3_xplained/sama5d3_xplainedsd_android_zimage_dt_defconfig
```kconfig
CONFIG_SAMA5D3_XPLAINED=y
CONFIG_CPU_CLK_528MHZ=y
CONFIG_RAM_512MB=y
CONFIG_SDCARD=y
CONFIG_LOAD_ANDROID=y
CONFIG_LINUX_ZIMAGE=y
CONFIG_DEBUG=y
CONFIG_SCLK=y
CONFIG_LOAD_ONE_WIRE=y
```

## board/sama5d3_xplained/sama5d3_xplainedsd_linux_zimage_dt_defconfig
```kconfig
CONFIG_SAMA5D3_XPLAINED=y
CONFIG_CPU_CLK_528MHZ=y
CONFIG_RAM_512MB=y
CONFIG_SDCARD=y
CONFIG_LOAD_LINUX=y
CONFIG_LINUX_ZIMAGE=y
CONFIG_MEM_SIZE="0x10000000"
CONFIG_DEBUG=y
CONFIG_SCLK=y
CONFIG_PM_EXTERNAL_DEVICES=y
CONFIG_ACT8865=y
```

## board/sama5d3_xplained/sama5d3_xplainedsd_uboot_defconfig
```kconfig
CONFIG_SAMA5D3_XPLAINED=y
CONFIG_CPU_CLK_528MHZ=y
CONFIG_RAM_512MB=y
CONFIG_SDCARD=y
CONFIG_DEBUG=y
CONFIG_SCLK=y
CONFIG_PM_EXTERNAL_DEVICES=y
CONFIG_ACT8865=y
```

## board/sama5d3xek/sama5d3xekdf_linux_zimage_dt_defconfig
```kconfig
CONFIG_SAMA5D3XEK=y
CONFIG_CPU_CLK_528MHZ=y
CONFIG_RAM_512MB=y
CONFIG_LOAD_LINUX=y
CONFIG_LINUX_ZIMAGE=y
CONFIG_DEBUG=y
CONFIG_SCLK=y
```

## board/sama5d3xek/sama5d3xeknf_android_uimage_dt_defconfig
```kconfig
CONFIG_SAMA5D3XEK=y
CONFIG_CPU_CLK_528MHZ=y
CONFIG_RAM_512MB=y
CONFIG_NANDFLASH=y
# CONFIG_PMECC_AUTO_DETECT is not set
CONFIG_PMECC_CORRECT_BITS_4=y
CONFIG_LOAD_ANDROID=y
# CONFIG_LOAD_1MB is not set
# CONFIG_LOAD_4MB is not set
# CONFIG_LOAD_64KB is not set
CONFIG_LINUX_UIMAGE=y
# CONFIG_LINUX_ZIMAGE is not set
CONFIG_MEM_BANK="0x20000000"
CONFIG_MEM_SIZE="0x20000000"
CONFIG_LINUX_KERNEL_ARG_STRING="console=ttyS0,115200 mtdparts=atmel_nand:5M(Bootstrap),125M(system),-(userdata) ubi.mtd=1 ubi.mtd=2 rw root=ubi0:system rootfstype=ubifs init=/init androidboot.console=ttyS0"
CONFIG_IMG_ADDRESS="0x00200000"
CONFIG_JUMP_ADDR="0x22000000"
CONFIG_OF_LIBFDT=y
CONFIG_OF_OFFSET="0x00180000"
CONFIG_OF_ADDRESS="0x21000000"

#
# Android Image Storage Setup
#
CONFIG_IMAGE_NAME="uImage"
# CONFIG_LONG_TEST is not set
CONFIG_DEBUG=y
CONFIG_SCLK=y
```

## board/sama5d3xek/sama5d3xeksd_android_zimage_dt_defconfig
```kconfig
CONFIG_SAMA5D3XEK=y
CONFIG_CPU_CLK_528MHZ=y
CONFIG_RAM_512MB=y
CONFIG_SDCARD=y
CONFIG_LOAD_ANDROID=y
CONFIG_LINUX_ZIMAGE=y
CONFIG_MEM_BANK="0x20000000"
CONFIG_MEM_SIZE="0x20000000"
CONFIG_LINUX_KERNEL_ARG_STRING="console=ttyS0,115200 root=/dev/mmcblk0p2 rw rootwait init=/init androidboot.console=ttyS0"
CONFIG_JUMP_ADDR="0x22000000"
CONFIG_OF_LIBFDT=y
CONFIG_OF_ADDRESS="0x21000000"

#
# Android Image Storage Setup
#
CONFIG_IMAGE_NAME="zImage"
# CONFIG_LONG_TEST is not set
CONFIG_DEBUG=y
CONFIG_SCLK=y
```

## board/sama5d4ek/sama5d4ekdf_uboot_defconfig
```kconfig
CONFIG_SAMA5D4EK=y
CONFIG_CPU_CLK_528MHZ=y
CONFIG_BUS_SPEED_176MHZ=y
CONFIG_RAM_512MB=y
CONFIG_DEBUG=y
CONFIG_SCLK=y
# CONFIG_REDIRECT_ALL_INTS_AIC is not set
CONFIG_ACT8865=y
```

## board/sama5d4ek/sama5d4ekdf_uboot_secure_defconfig
```kconfig
CONFIG_SAMA5D4EK=y
CONFIG_CPU_CLK_528MHZ=y
CONFIG_BUS_SPEED_176MHZ=y
CONFIG_RAM_512MB=y
CONFIG_IMG_ADDRESS="0x00020000"
CONFIG_DEBUG=y
CONFIG_SCLK=y
# CONFIG_ENTER_NWD is not set
CONFIG_PM_EXTERNAL_DEVICES=y
CONFIG_ACT8865=y
CONFIG_LOAD_ONE_WIRE=y
```

## board/sama5d4ek/sama5d4eksd_uboot_secure_defconfig
```kconfig
CONFIG_SAMA5D4EK=y
CONFIG_CPU_CLK_528MHZ=y
CONFIG_BUS_SPEED_176MHZ=y
CONFIG_RAM_512MB=y
CONFIG_SDCARD=y
CONFIG_DEBUG=y
CONFIG_SCLK=y
# CONFIG_ENTER_NWD is not set
CONFIG_PM_EXTERNAL_DEVICES=y
CONFIG_ACT8865=y
```

## board/sama7g5ek/sama7g5eknone_defconfig
```kconfig
CONFIG_SAMA7G5EK=y
CONFIG_RAM_512MB=y
CONFIG_LOAD_NONE=y
CONFIG_DEBUG=y
CONFIG_DEBUG_VERY_LOUD=y
# CONFIG_MATRIX is not set
# CONFIG_ENTER_NWD is not set
# CONFIG_REDIRECT_ALL_INTS_AIC is not set
CONFIG_TZC400=y
# CONFIG_RSTC is not set
```

## configs/ourasi_ddr3_ebsd1_uboot_defconfig
```kconfig
# Copyright (C) 2006 Microchip Technology Inc. and its subsidiaries
#
# SPDX-License-Identifier: MIT

CONFIG_SAMA7D65=y
CONFIG_CPU_CLK_800MHZ=y
CONFIG_DEBUG=y
CONFIG_DDR_SET_BY_DEVICE=y
CONFIG_DDR_MT41K128M16JT_125=y
CONFIG_DDR_2_GBIT=y
CONFIG_MEM_CLOCK_533=y
CONFIG_SDCARD=y
CONFIG_SDHC1=y
CONFIG_JUMP_ADDR="0x66f00000"
# CONFIG_REDIRECT_ALL_INTS_AIC is not set
CONFIG_TZC400=y
CONFIG_MCP16502=y
CONFIG_MCP16502_SET_VOLTAGE=y
CONFIG_PMIC_ON_TWI=0
CONFIG_VOLTAGE_OUT4=1150
CONFIG_BOARD_QUIRK_OURASI_DDR3_EB=y
CONFIG_LED_ON_BOARD=y
CONFIG_LED_R_ON_PIOA=y
CONFIG_LED_R_PIN=19
CONFIG_LED_G_ON_PIOA=y
CONFIG_LED_G_PIN=20
CONFIG_LED_B_ON_PIOA=y
CONFIG_LED_B_PIN=21
CONFIG_FLEXCOM5=y
CONFIG_FLEXCOM5_IOSET=1
CONFIG_WDTS=y
```

## configs/rugged_board_a5d2xqspi_uboot_defconfig
```kconfig
CONFIG_CRYSTAL_24_000MHZ=y
CONFIG_DEBUG=y
CONFIG_DDR_512_MBIT=y
CONFIG_MX25l25645G=y
CONFIG_SPI_CLK=66000000
CONFIG_QSPI=y
CONFIG_QSPI_BUS=1
CONFIG_QSPI_IOSET=2
CONFIG_IMG_ADDRESS="0x00020000"
CONFIG_JUMP_ADDR="0x22000000"
CONFIG_IMG_SIZE="0x00080000"
CONFIG_BOARD_QUIRK_SAMA5D2_SIP=y
CONFIG_LED_ON_BOARD=y
CONFIG_LED_R_ON_PIOA=y
CONFIG_LED_R_PIN=10
CONFIG_LED_G_ON_PIOB=y
CONFIG_LED_G_PIN=1
CONFIG_LED_B_ON_PIOA=y
CONFIG_LED_B_PIN=31
```

## configs/rugged_board_a5d2xsd1_uboot_defconfig
```kconfig
CONFIG_CRYSTAL_24_000MHZ=y
CONFIG_DEBUG=y
CONFIG_DDR_512_MBIT=y
CONFIG_SDCARD=y
CONFIG_SDHC1=y
CONFIG_JUMP_ADDR="0x22000000"
CONFIG_BOARD_QUIRK_SAMA5D2_SIP=y
CONFIG_LED_ON_BOARD=y
CONFIG_LED_R_ON_PIOA=y
CONFIG_LED_R_PIN=10
CONFIG_LED_G_ON_PIOB=y
CONFIG_LED_G_PIN=1
CONFIG_LED_B_ON_PIOA=y
CONFIG_LED_B_PIN=31
```

## configs/sam9x60_curiositynf_uboot_defconfig
```kconfig
CONFIG_SAM9X60=y
CONFIG_DEBUG=y
CONFIG_LOAD_HW_INFO=y
CONFIG_DDRC=y
CONFIG_DDR_SET_BY_DEVICE=y
CONFIG_DDR_W971GG6SB=y
CONFIG_NANDFLASH=y
# CONFIG_PMECC_AUTO_DETECT is not set
CONFIG_PMECC_PAGESIZE_4096=y
CONFIG_PMECC_OOB_256=y
CONFIG_PMECC_CORRECT_BITS_8=y
CONFIG_NAND_TIMING_MODE=y
CONFIG_IMG_SIZE="0x000c0000"
CONFIG_THUMB=y
CONFIG_BOARD_QUIRK_SAM9X60_CURIOSITY=y
CONFIG_LED_ON_BOARD=y
CONFIG_LED_R_ON_PIOD=y
CONFIG_LED_R_PIN=17
CONFIG_LED_G_ON_PIOD=y
CONFIG_LED_G_PIN=19
CONFIG_LED_B_ON_PIOD=y
CONFIG_LED_B_PIN=21
CONFIG_LOAD_EEPROM=y
CONFIG_EEPROM_ADDR=0x53
```
