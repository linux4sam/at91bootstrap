## Config.in
```kconfig
mainmenu "AT91 Bootstrap configuration"

config HAVE_DOT_CONFIG
	bool
	default y
	help
	  Indicate that have an included file.

source "board/Config.in"

source "driver/Config.in.driver"

config CONFIG_PROJECT
	string
	default "dataflash"	if CONFIG_DATAFLASH
	default "flash"		if CONFIG_FLASH
	default "nandflash"	if CONFIG_NANDFLASH
	default "sdcard"	if CONFIG_SDCARD

choice
	prompt "Image Loading Strategy"
	default CONFIG_LOAD_UBOOT

config CONFIG_LOAD_UBOOT
	bool "Load U-Boot into last MBYTE of SDRAM"
	help
	  Use this mode to load an second level boot monitor
	  like U-boot into the last MB of SDRAM.

config CONFIG_LOAD_LINUX
	select CONFIG_LINUX_IMAGE
	bool "Support loading Linux directly"
	---help---
	   Load Linux kernel directly from storage media

config CONFIG_LOAD_NONE
	bool "Do not load any image after bootstrap run"
	help
	  Do not not load any image after bootstrap run.
	  Bootstrap will endless loop, use JTAG to load application.

config CONFIG_LOAD_ANDROID
	select CONFIG_LINUX_IMAGE
	bool "Support loading Android directly"
	help
	   Load Android image directly from storage media

config CONFIG_LOAD_1MB
	bool "Load 1 MB into start of SDRAM"
	help
	  Use this mode to load an embedded application
	  which can have a size of up to 1 MByte

config CONFIG_LOAD_4MB
	bool "Load 4 MB into start of SDRAM"
	help
	  Use this mode to load an embedded application
	  which can have a size of up to 4 MByte

config CONFIG_LOAD_64KB
	bool "Load 64 kB into the start of SDRAM"
	help
	  Use this mode to load an embedded application
	  which can have max 64 kB Size

endchoice

config CONFIG_LINUX_IMAGE
	depends on CONFIG_LOAD_LINUX || CONFIG_LOAD_ANDROID
	bool
	help
	  Select to load linux uImage or zImage to boot

#
# Kernel Image Storage Setup
#
source "Config.in.kernel"

#
# U-Boot Image Storage Setup
#
source "Config.in.u-boot"

#
# Demo App Image Storage Setup
#
source "Config.in.app-image"

#
# No Image Storage Setup
#
source "Config.in.none"

config CONFIG_IMAGE_NAME
	depends on CONFIG_FATFS
	string "Image Name"
	default "Image" if CONFIG_LINUX_IMAGE
	default "u-boot.bin" if CONFIG_LOAD_UBOOT
	default "softpack.bin" if CONFIG_LOAD_64KB || CONFIG_LOAD_4MB || CONFIG_LOAD_1MB
	default "none" if CONFIG_LOAD_NONE

config CONFIG_DEBUG
	bool "Debug Support"
	default n
	help
	  Output Debug messages
choice
	prompt "Debug Level"
	depends on CONFIG_DEBUG

config CONFIG_DEBUG_INFO
	bool "General debug information"

config CONFIG_DEBUG_LOUD
	bool "Loud debug output"

config CONFIG_DEBUG_VERY_LOUD
	bool "Even louder debug output"

endchoice

source "Config.in.secure"

config CONFIG_THUMB
	depends on !(SAMA5D3X || SAMA5D4)
	bool "Build in thumb mode"
	help
	  Build code in thumb mode

config CONFIG_DISABLE_WATCHDOG
	bool "Disable Watchdog"
	default y
	help
	  Disable the watchdog in the boostrap

menu "Hardware Initialization Options"

config CONFIG_HW_DISPLAY_BANNER
	bool "Display Banner"
	default y
	help
	  Display banner

config CONFIG_HW_BANNER
	string Banner
	default "\"\\n\\nAT91Bootstrap \" AT91BOOTSTRAP_VERSION \" (\" COMPILE_TIME \")\\n\\n\""
	depends on CONFIG_HW_DISPLAY_BANNER
	help
	  The banner displayed on serial port

config CONFIG_HW_INIT
	bool "Call Hardware Initialization"
	default y
	help
	  Initialize Hardware

config CONFIG_USER_HW_INIT
	bool "Call User specific Hardware Initialization"
	help
	  Initialize Hardware

endmenu

menu "Slow Clock Configuration Options"
	depends on CPU_HAS_SCKC

config CONFIG_SCLK
	bool "Use external 32KHZ oscillator as source of slow clock"
	default y
	help
	  Use external 32KHZ oscillator as source of slow clock

config CONFIG_SCLK_BYPASS
	depends on CONFIG_SCLK
	bool "Use external 32kHz clock as source of slow clock"
	default n
	help
	  Use external 32kHz clock as source of slow clock

endmenu

menu "ARM TrustZone Options"
	depends on CPU_HAS_TRUSTZONE

config CONFIG_MATRIX
	bool "Enable Configure the Matrix"
	default y
	help
	  This interface let you to configure the MATRIX0(H64MX) and
	  MATRIX1(H32MX) slave security  and to select the APB slave security startup.

config CONFIG_ENTER_NWD
	select CONFIG_MATRIX
	bool "Enable Enter the Normal World before Jumping"
	default y
	help
	  This interface let you to make the system to enter from the Secure World
	  to the Non-Secure World before the jumping.

config CONFIG_REDIRECT_ALL_INTS_AIC
	bool "Redirect All Peripherals Interrupts to AIC"
	default y
	help
	  This interface let you to redirect all peripherals interrupts to AIC,
	  otherwise, the secure peripherals interrupts direct to SAIC, others to AIC.

endmenu

config CONFIG_PM
	bool "Power Management Options"
	depends on CONFIG_SUPPORT_PM
	default y
	help
	  This interface let you select the external devices on the board to
	  enter the power down mode at startup, such as Audio Codec(wm8904), HDMI(SiI9022ACUN)
	  and ethernet PHY(KSZ8081RNB). Its purpose is to make sure the external devices
	  which will not be touched in the kernel are set the proper power state.

menu "Select the Devices to the Low-power mode"
	depends on CONFIG_PM

config CONFIG_MAC0_PHY
	bool "MAC0 PHYs"
	depends on CONFIG_HAS_EHT0_PHY
	select CONFIG_MACB
	default y
	help
	  This interface allow you to select the MAC0 PHY on the board
	  which will be put into the Power-Down mode.

config CONFIG_MAC1_PHY
	bool "MAC1 PHYs"
	depends on CONFIG_HAS_EHT1_PHY
	select CONFIG_MACB
	default y
	help
	  This interface allow you to select the MAC1 PHY on the board
	  which will be put into the Power-Down mode.

config CONFIG_HDMI
	bool "HDMI (SiI9022)"
	depends on CONFIG_HAS_HDMI
	select CONFIG_TWI
	default y
	help
	  This interface allow you to select the HDMI chip on the board
	  which will be put into the Power-Down mode.

choice
	prompt "HDMI on TWI Select"
	depends on CONFIG_HDMI && !CONFIG_AUTOCONFIG_TWI_BUS
	default CONFIG_HDMI_ON_TWI0
	help
	  This interface allow you select which TWI bus for the HDMI to wire on.

config	CONFIG_HDMI_ON_TWI0
	bool "On TWI0"
	depends on CPU_HAS_TWI0
	select CONFIG_TWI0

config	CONFIG_HDMI_ON_TWI1
	bool "On TWI1"
	depends on CPU_HAS_TWI1
	select CONFIG_TWI1

config	CONFIG_HDMI_ON_TWI2
	bool "On TWI2"
	depends on CPU_HAS_TWI2
	select CONFIG_TWI2

config	CONFIG_HDMI_ON_TWI3
	bool "On TWI3"
	depends on CPU_HAS_TWI3
	select CONFIG_TWI3

endchoice

config CONFIG_WM8904
	bool "Audio CODEC (wm8904)"
	depends on CONFIG_HAS_AUDIO_CODEC
	select CONFIG_TWI
	default y
	help
	  This interface allow you to select the CODEC chip on the board
	  which will be put into the Power-Down mode.

choice
	prompt "CODEC on TWI Select"
	depends on CONFIG_WM8904 && !CONFIG_AUTOCONFIG_TWI_BUS
	default CONFIG_CODEC_ON_TWI0
	help
	  This interface allow you select which TWI bus for the CODEC to wire on.

config	CONFIG_CODEC_ON_TWI0
	bool "On TWI0"
	depends on CPU_HAS_TWI0
	select CONFIG_TWI0

config	CONFIG_CODEC_ON_TWI1
	bool "On TWI1"
	depends on CPU_HAS_TWI1
	select CONFIG_TWI1

config	CONFIG_CODEC_ON_TWI2
	bool "On TWI2"
	depends on CPU_HAS_TWI2
	select CONFIG_TWI2

config	CONFIG_CODEC_ON_TWI3
	bool "On TWI3"
	depends on CPU_HAS_TWI3
	select CONFIG_TWI3

endchoice

config CONFIG_PM_PMIC
	bool "PMIC (ACT8865)"
	depends on CONFIG_HAS_PMIC_ACT8865
	select CONFIG_ACT8865
	default y
	help
	  This interface allow you to select the PMIC(ACT8865) chip on the board
	  which will be set the Power-Saving mode.

endmenu

config CONFIG_BACKUP_MODE
	bool "Enable Backup Mode"
	default n
	help
	  Enables "Backup mode". Starting with sama5d2, it is possible to put
	  use DDR Self Refresh and shutdown the core. Resuming from that state
	  requires support in the bootloader.


menu "Board's Workaround Options"
	depends on CONFIG_HAS_PMIC_ACT8865

config CONFIG_ACT8865_SET_VOLTAGE
	bool "Set ACT8865 Initial Output Voltage"
	select CONFIG_ACT8865
	default n
	help
	  This interface let you to set the ACT8865 initial output value

config CONFIG_DISABLE_ACT8865_I2C
	bool "Disable the ACT8865 I2C interface"
	depends on CONFIG_HAS_PMIC_ACT8865
	select CONFIG_ACT8865
	select CONFIG_ACT8865_SET_VOLTAGE
	default y
	help
	  This interface let you to disable the ACT8865's I2C interface.
	  There are some issue about active-semi ACT8865's I2C interface,
	  which affects the other chip which stands on the same I2C bus, such as MXT touchscreen.

config CONFIG_SUSPEND_ACT8945A_CHARGER
	bool "Suspend ACT8945A Charger"
	select CONFIG_ACT8865
	default n
	help
	  This interface let you to suspend the ACT8945A charger
	  function after boot.

endmenu

config CONFIG_ACT8865
	bool "PMIC (ACT8865) Support"
	depends on CONFIG_HAS_PMIC_ACT8865
	select CONFIG_TWI
	default n

choice
	prompt "PMIC (ACT8865) on TWI Select"
	depends on CONFIG_ACT8865 && !CONFIG_AUTOCONFIG_TWI_BUS
	default CONFIG_PMIC_ON_TWI0
	help
	  This interface allow you select which TWI bus for the PMIC to wire on.

config	CONFIG_PMIC_ON_TWI0
	bool "On TWI0"
	depends on CPU_HAS_TWI0
	select CONFIG_TWI0

config	CONFIG_PMIC_ON_TWI1
	bool "On TWI1"
	depends on CPU_HAS_TWI1
	select CONFIG_TWI1

config	CONFIG_PMIC_ON_TWI2
	bool "On TWI2"
	depends on CPU_HAS_TWI2
	select CONFIG_TWI2

config	CONFIG_PMIC_ON_TWI3
	bool "On TWI3"
	depends on CPU_HAS_TWI2
	select CONFIG_TWI3

endchoice

menu "Board Hardware Information Options"
	depends on CONFIG_HAS_HW_INFO

config CONFIG_LOAD_ONE_WIRE
	bool "Load Information from 1-Wire"
	depends on CONFIG_HAS_ONE_WIRE
	select CONFIG_LOAD_HW_INFO
	default y
	help
	  This interface allow you to select hardware information from 1-Wire chips.

config CONFIG_LOAD_EEPROM
	bool "Load Information from EEPROM"
	depends on CONFIG_HAS_EEPROM
	select CONFIG_TWI
	select CONFIG_LOAD_HW_INFO
	default y
	help
	  This interface allow you to select hardware information from EEPROM chips.

choice
	prompt "EEPROM on TWI Select"
	depends on CONFIG_LOAD_EEPROM && !CONFIG_AUTOCONFIG_TWI_BUS
	default CONFIG_EEPROM_ON_TWI0
	help
	  This interface allow you select which TWI bus for the EEPROM to wire on.

config	CONFIG_EEPROM_ON_TWI0
	bool "On TWI0"
	depends on CPU_HAS_TWI0
	select CONFIG_TWI0

config	CONFIG_EEPROM_ON_TWI1
	bool "On TWI1"
	depends on CPU_HAS_TWI1
	select CONFIG_TWI1

config	CONFIG_EEPROM_ON_TWI2
	bool "On TWI2"
	depends on CPU_HAS_TWI2
	select CONFIG_TWI2

config	CONFIG_EEPROM_ON_TWI3
	bool "On TWI3"
	depends on CPU_HAS_TWI3
	select CONFIG_TWI3

endchoice

endmenu

config CONFIG_AUTOCONFIG_TWI_BUS
	bool "Auto Configure TWI Bus by Board"
	depends on CONFIG_TWI
	select CONFIG_TWI0 if CPU_HAS_TWI0
	select CONFIG_TWI1 if CPU_HAS_TWI1
	select CONFIG_TWI2 if CPU_HAS_TWI2
	select CONFIG_TWI3 if CPU_HAS_TWI3
	default y
	help
	  This interface allow the board determines  which TWI bus that
	  the HDMI, Audio CODEC(wm8904), PMIC(ACT8865) is wired on,
	  select automatically, no menuconfig selecting to need.
```
