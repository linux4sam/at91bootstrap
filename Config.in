## board/Config.in
```kconfig
config	HAVE_DOT_CONFIG
	bool
	default y

choice
	prompt "Board Type"
	default	CONFIG_AT91SAM9260EK
	help
	  Select which board you want to build for

source "board/at91sam9260ek/Config.in.board"
source "board/at91sam9261ek/Config.in.board"
source "board/at91sam9263ek/Config.in.board"
source "board/at91sam9rlek/Config.in.board"
source "board/at91sam9xeek/Config.in.board"
source "board/at91sam9g10ek/Config.in.board"
source "board/at91sam9g20ek/Config.in.board"
source "board/at91sam9m10g45ek/Config.in.board"
source "board/at91sam9x5ek/Config.in.board"
source "board/at91sam9n12ek/Config.in.board"
source "board/sama5d3xek/Config.in.board"
source "board/sama5d3_xplained/Config.in.board"
source "board/sama5d3x_cmp/Config.in.board"
source "board/sama5d4ek/Config.in.board"
source "board/sama5d4_xplained/Config.in.board"
source "board/sama5d2_ptc_ek/Config.in.board"
source "board/sama5d2_xplained/Config.in.board"
source "board/sama5d27_som1_ek/Config.in.board"
source "board/sama5d2_lpddr2sip_vb/Config.in.board"
source "contrib/board/Config.in.board"

endchoice

config CONFIG_BOARDNAME
	string
	default "at91sam9rlek"	if CONFIG_AT91SAM9RLEK
	default "at91sam9260ek"	if CONFIG_AT91SAM9260EK
	default "at91sam9261ek"	if CONFIG_AT91SAM9261EK
	default "at91sam9263ek"	if CONFIG_AT91SAM9263EK
	default "at91sam9xeek"	if CONFIG_AT91SAM9XEEK
	default "at91sam9g10ek"	if CONFIG_AT91SAM9G10EK
	default "at91sam9g20ek"	if CONFIG_AT91SAM9G20EK
	default "at91sam9m10g45ek" if CONFIG_AT91SAM9M10G45EK
	default "at91sam9n12ek"	if CONFIG_AT91SAM9N12EK
	default "at91sam9x5ek"	if CONFIG_AT91SAM9X5EK
	default "sama5d3_xplained" if CONFIG_SAMA5D3_XPLAINED
	default "sama5d3xek" if CONFIG_SAMA5D3XEK
	default "sama5d3x_cmp" if CONFIG_SAMA5D3X_CMP
	default "sama5d4_xplained" if CONFIG_SAMA5D4_XPLAINED
	default "sama5d4ek" if CONFIG_SAMA5D4EK
	default "sama5d2_ptc_ek" if CONFIG_SAMA5D2_PTC_EK
	default "sama5d2_xplained" if CONFIG_SAMA5D2_XPLAINED
	default "sama5d27_som1_ek" if CONFIG_SAMA5D27_SOM1_EK
	default "sama5d2_lpddr2sip_vb" if CONFIG_SAMA5D2_LPDDR2SIP_VB
source "contrib/board/Config.in.boardname"

config AT91SAM9260
	select CORE_ARM926EJS
	select CPU_HAS_TWI0
	select CPU_HAS_MCI0
	select CPU_HAS_SPI0
	select CPU_HAS_SPI1
	bool

config AT91SAM9261
	select CORE_ARM926EJS
	select CPU_HAS_TWI0
	select CPU_HAS_MCI0
	select CPU_HAS_SPI0
	select CPU_HAS_SPI1
	bool

config AT91SAM9263
	select CORE_ARM926EJS
	select CPU_HAS_TWI0
	select CPU_HAS_MCI0
	select CPU_HAS_MCI1
	select CPU_HAS_SPI0
	select CPU_HAS_SPI1
	bool

config AT91SAM9RL
	select CORE_ARM926EJS
	select CPU_HAS_TWI0
	select CPU_HAS_TWI1
	select CPU_HAS_SCKC
	select CPU_HAS_SPI0
	bool

config AT91SAM9XE
	select CORE_ARM926EJS
	select CPU_HAS_TWI0
	select CPU_HAS_TWI1
	select CPU_HAS_MCI0
	select CPU_HAS_SPI0
	select CPU_HAS_SPI1
	bool

config AT91SAM9G10
	select CORE_ARM926EJS
	select CPU_HAS_TWI0
	select CPU_HAS_MCI0
	select CPU_HAS_SPI0
	select CPU_HAS_SPI1
	bool

config AT91SAM9G20
	select CORE_ARM926EJS
	select CPU_HAS_TWI0
	select CPU_HAS_MCI0
	select CPU_HAS_SPI0
	select CPU_HAS_SPI1
	bool

config AT91SAM9G45
	select CORE_ARM926EJS
	select CPU_HAS_TWI0
	select CPU_HAS_TWI1
	select CPU_HAS_SCKC
	select CPU_HAS_HSMCI0
	select CPU_HAS_HSMCI1
	select CPU_HAS_SPI0
	select CPU_HAS_SPI1
	bool

config AT91SAM9X5
	select CORE_ARM926EJS
	select CPU_HAS_TWI0
	select CPU_HAS_TWI1
	select CPU_HAS_TWI2
	select CPU_HAS_SCKC
	select CPU_HAS_PIO3
	select CPU_HAS_PMECC
	select CPU_HAS_HSMCI0
	select CPU_HAS_HSMCI1
	select CPU_HAS_SPI0
	select CPU_HAS_SPI1
	bool

config AT91SAM9N12
	select CORE_ARM926EJS
	select CPU_HAS_TWI0
	select CPU_HAS_TWI1
	select CPU_HAS_SCKC
	select CPU_HAS_PIO3
	select CPU_HAS_PMECC
	select CPU_HAS_HSMCI0
	select CPU_HAS_SPI0
	select CPU_HAS_SPI1
	bool

config SAMA5D3X
	select CORE_CORTEX_A5
	select CPU_HAS_TWI0
	select CPU_HAS_TWI1
	select CPU_HAS_TWI2
	select CPU_HAS_AES
	select CPU_HAS_SCKC
	select CPU_HAS_PIO3
	select CPU_HAS_PMECC
	select CPU_HAS_HSMCI0
	select CPU_HAS_HSMCI1
	select CPU_HAS_HSMCI2
	select CPU_HAS_SPI0
	select CPU_HAS_SPI1
	bool

config SAMA5D4
	select CORE_CORTEX_A5
	select CPU_HAS_TWI0
	select CPU_HAS_TWI1
	select CPU_HAS_TWI2
	select CPU_HAS_TWI3
	select CPU_HAS_AES
	select CPU_HAS_L2CC
	select CPU_HAS_SCKC
	select CPU_HAS_H32MXDIV
	select CPU_HAS_PIO3
	select CPU_HAS_PMECC
	select CPU_HAS_TRUSTZONE
	select CPU_HAS_HSMCI0
	select CPU_HAS_HSMCI1
	select CPU_HAS_SPI0
	select CPU_HAS_SPI1
	select CPU_HAS_SPI2
	bool

config SAMA5D2
	select CORE_CORTEX_A5
	select CPU_HAS_TWI0
	select CPU_HAS_TWI1
	select CPU_HAS_AES
	select CPU_HAS_L2CC
	select CPU_HAS_SCKC
	select CPU_HAS_H32MXDIV
	select CPU_HAS_PIO4
	select CPU_HAS_PMECC
	select CPU_HAS_TRUSTZONE
	select CPU_HAS_SDHC0
	select CPU_HAS_SDHC1
	select CPU_HAS_SPI0
	select CPU_HAS_SPI1
	select CPU_HAS_SPI0_IOSET1
	select CPU_HAS_SPI0_IOSET2
	select CPU_HAS_SPI1_IOSET1
	select CPU_HAS_SPI1_IOSET2
	select CPU_HAS_SPI1_IOSET3
	select CPU_HAS_QSPI0
	select CPU_HAS_QSPI1
	select CPU_HAS_QSPI0_IOSET1
	select CPU_HAS_QSPI0_IOSET2
	select CPU_HAS_QSPI0_IOSET3
	select CPU_HAS_QSPI1_IOSET1
	select CPU_HAS_QSPI1_IOSET2
	select CPU_HAS_QSPI1_IOSET3
	bool

config CONFIG_MACH_TYPE
	string
	default "1099"	if AT91SAM9260
	default "0x350"	if AT91SAM9261
	default "0x4B2"	if AT91SAM9263
	default "1326"	if AT91SAM9RL
	default "0x44B"	if AT91SAM9XE
	default "0x86F"	if AT91SAM9G10
	default "0x658"	if AT91SAM9G20
	default "1830"	if AT91SAM9G45
	default "3373"	if AT91SAM9X5
	default "9999"	if AT91SAM9N12
	default "9999"	if SAMA5D3X
	default "9999"	if SAMA5D4
	default "9999"	if SAMA5D2
	help

config CONFIG_OVERRIDE_MACH_TYPE
	bool "Override the default mach type"
	default n
	help
	  This setting will let you choose a custom mach type.
	  The selected CUSTOM_MACH_TYPE will override the autoselected
	  MACH_TYPE setting which is based on the selected board.

if CONFIG_OVERRIDE_MACH_TYPE

config CONFIG_CUSTOM_MACH_TYPE
	string "custom mach type"
	default CONFIG_MACH_TYPE
	help
	  Custom mach type

endif

config CONFIG_LINK_ADDR
	string
	default "0x200000" if AT91SAM9260 || AT91SAM9G20 || SAMA5D4  || SAMA5D2
	default "0x300000" if !(AT91SAM9260 && AT91SAM9G20)
	help

config CONFIG_DATA_SECTION_ADDR
	string
	default "0x304000" if AT91SAM9XE
	help

config CONFIG_TOP_OF_MEMORY
	string
	default "0x301000"	if AT91SAM9260
	default "0x328000"	if AT91SAM9261
	default "0x314000"	if AT91SAM9263
	default "0x310000"	if AT91SAM9RL
	default "0x306000"	if AT91SAM9XE
	default "0x304000"	if AT91SAM9G10
	default "0x304000"	if AT91SAM9G20
	default "0x30A000"	if AT91SAM9G45
	default "0x308000"	if AT91SAM9X5
	default "0x308000"	if AT91SAM9N12
	default "0x310000"	if SAMA5D3X
	default "0x210000"	if SAMA5D4
	default "0x210000"	if SAMA5D2
	help
	    The top address of internal SRAM

choice
	prompt "Crystal Frequency"
	default CONFIG_CRYSTAL_18_432MHZ
	help
	  Select the crystal frequency

config CONFIG_CRYSTAL_12_000MHZ
	bool "Build for use of an 12.000 MHz crystal"
	depends on ALLOW_CRYSTAL_12_000MHZ

config CONFIG_CRYSTAL_16_000MHZ
	bool "Build for use of an 16.000 MHz crystal"
	depends on ALLOW_CRYSTAL_16_000MHZ

config CONFIG_CRYSTAL_16_36766MHZ
	bool "Build for use of an 16.36766 MHz crystal"
	depends on ALLOW_CRYSTAL_16_36766MHZ

config CONFIG_CRYSTAL_18_432MHZ
	bool "Build for use of an 18.432 MHz crystal"
	depends on ALLOW_CRYSTAL_18_432MHZ

config CONFIG_CRYSTAL_24_000MHZ
	bool "Build for use of an 24.000 MHz crystal"
	depends on ALLOW_CRYSTAL_24_000MHZ

endchoice

config ALLOW_CRYSTAL_12_000MHZ
	bool

config ALLOW_CRYSTAL_16_000MHZ
	bool

config ALLOW_CRYSTAL_16_36766MHZ
	bool

config ALLOW_CRYSTAL_18_432MHZ
	bool

config ALLOW_CRYSTAL_24_000MHZ
	bool

config CONFIG_CRYSTAL
	string


config CONFIG_CRYSTAL
	string
	default "CRYSTAL_12_000MHZ"	if CONFIG_CRYSTAL_12_000MHZ 
	default "CRYSTAL_16_000MHZ"	if CONFIG_CRYSTAL_16_000MHZ
	default "CRYSTAL_16_36766MHZ"	if CONFIG_CRYSTAL_16_36766MHZ
	default "CRYSTAL_18_432MHZ"	if CONFIG_CRYSTAL_18_432MHZ
	default "CRYSTAL_24_000MHZ"     if CONFIG_CRYSTAL_24_000MHZ
	default "CRYSTAL_18_432MHZ"

choice
	prompt "CPU clock"
	default CONFIG_CPU_CLK_200MHZ
	default CONFIG_CPU_CLK_492MHZ if CONFIG_SAMA5D2_PTC_EK
	default CONFIG_CPU_CLK_498MHZ if CONFIG_SAMA5D2_XPLAINED
	default CONFIG_CPU_CLK_492MHZ if CONFIG_SAMA5D27_SOM1_EK
	default CONFIG_CPU_CLK_498MHZ if CONFIG_SAMA5D2_LPDDR2SIP_VB


config	CONFIG_CPU_CLK_166MHZ
	bool "166 MHz"
	depends on ALLOW_CPU_CLK_166MHZ

config	CONFIG_CPU_CLK_180MHZ
	bool "180 MHz"
	depends on ALLOW_CPU_CLK_180MHZ

config	CONFIG_CPU_CLK_200MHZ
	bool "200 MHz"
	depends on ALLOW_CPU_CLK_200MHZ

config	CONFIG_CPU_CLK_240MHZ
	bool "240 MHz"
	depends on ALLOW_CPU_CLK_240MHZ
	depends on !DISABLE_CPU_CLK_240MHZ

config	CONFIG_CPU_CLK_266MHZ
	bool "266 MHz"
	depends on ALLOW_CPU_CLK_266MHZ

config	CONFIG_CPU_CLK_332MHZ
	bool "332 MHz"
	depends on ALLOW_CPU_CLK_332MHZ

config	CONFIG_CPU_CLK_348MHZ
	bool "348 MHz"
	depends on ALLOW_CPU_CLK_348MHZ

config	CONFIG_CPU_CLK_396MHZ
	bool "396 MHz"
	depends on ALLOW_CPU_CLK_396MHZ

config	CONFIG_CPU_CLK_400MHZ
	bool "400 MHz"
	depends on ALLOW_CPU_CLK_400MHZ

config	CONFIG_CPU_CLK_444MHZ
	bool "444 MHz"
	depends on ALLOW_CPU_CLK_444MHZ

config CONFIG_CPU_CLK_492MHZ
	bool "492 MHz"
	depends on ALLOW_CPU_CLK_492MHZ

config CONFIG_CPU_CLK_498MHZ
	bool "498 MHz"
	depends on ALLOW_CPU_CLK_498MHZ

config CONFIG_CPU_CLK_510MHZ
	bool "510 MHz"
	depends on ALLOW_CPU_CLK_510MHZ

config CONFIG_CPU_CLK_528MHZ
	bool "528 MHz"
	depends on ALLOW_CPU_CLK_528MHZ

config CONFIG_CPU_CLK_594MHZ
	bool "594 MHz"
	depends on ALLOW_CPU_CLK_594MHZ

config CONFIG_CPU_CLK_600MHZ
	bool "600 MHz"
	depends on ALLOW_CPU_CLK_600MHZ

endchoice

config	ALLOW_CPU_CLK_166MHZ
	bool

config	ALLOW_CPU_CLK_180MHZ
	bool

config	ALLOW_CPU_CLK_200MHZ
	bool

config	ALLOW_CPU_CLK_240MHZ
	bool

config	ALLOW_CPU_CLK_266MHZ
	bool

config	ALLOW_CPU_CLK_332MHZ
	bool

config	ALLOW_CPU_CLK_348MHZ
	bool

config	ALLOW_CPU_CLK_396MHZ
	bool

config	ALLOW_CPU_CLK_400MHZ
	bool

config	ALLOW_CPU_CLK_444MHZ
	bool

config  ALLOW_CPU_CLK_492MHZ
	bool

config  ALLOW_CPU_CLK_498MHZ
	bool

config  ALLOW_CPU_CLK_510MHZ
	bool

config  ALLOW_CPU_CLK_528MHZ
	bool

config  ALLOW_CPU_CLK_594MHZ
	bool

config  ALLOW_CPU_CLK_600MHZ
	bool

config	DISABLE_CPU_CLK_240MHZ
	bool
	default y if CONFIG_AT91SAM9263EK && CONFIG_CRYSTAL_16_36766MHZ
	default n

choice
	prompt "Bus Speed"
	default CONFIG_BUS_SPEED_133MHZ
	help
	  Select the speed of the bus

config CONFIG_BUS_SPEED_83MHZ
	bool "83 MHz"
	depends on SUPPORT_BUS_SPEED_83MHZ && CONFIG_CPU_CLK_166MHZ

config CONFIG_BUS_SPEED_90MHZ
	bool "90 MHz"
	depends on SUPPORT_BUS_SPEED_90MHZ && CONFIG_CPU_CLK_180MHZ

config CONFIG_BUS_SPEED_100MHZ
	bool "100 MHz"
	depends on SUPPORT_BUS_SPEED_100MHZ && (CONFIG_CPU_CLK_200MHZ || CONFIG_CPU_CLK_400MHZ)

config CONFIG_BUS_SPEED_116MHZ
	bool "116 MHz"
	depends on SUPPORT_BUS_SPEED_116MHZ && CONFIG_CPU_CLK_348MHZ

config CONFIG_BUS_SPEED_124MHZ
	bool "124 MHz"
	depends on SUPPORT_BUS_SPEED_124MHZ && CONFIG_CPU_CLK_498MHZ

config CONFIG_BUS_SPEED_133MHZ
	bool "133 MHz"
	depends on SUPPORT_BUS_SPEED_133MHZ && (CONFIG_CPU_CLK_528MHZ || CONFIG_CPU_CLK_400MHZ || CONFIG_CPU_CLK_396MHZ || CONFIG_CPU_CLK_266MHZ)

config CONFIG_BUS_SPEED_148MHZ
	bool "148 MHz"
	depends on SUPPORT_BUS_SPEED_148MHZ && (CONFIG_CPU_CLK_444MHZ || CONFIG_CPU_CLK_594MHZ)

config CONFIG_BUS_SPEED_164MHZ
	bool "164 MHz"
	depends on SUPPORT_BUS_SPEED_164MHZ && CONFIG_CPU_CLK_492MHZ

config CONFIG_BUS_SPEED_166MHZ
	bool "166 MHz"
	depends on SUPPORT_BUS_SPEED_166MHZ && (CONFIG_CPU_CLK_498MHZ || CONFIG_CPU_CLK_332MHZ)

config CONFIG_BUS_SPEED_170MHZ
	bool "170 MHz"
	depends on SUPPORT_BUS_SPEED_170MHZ && CONFIG_CPU_CLK_510MHZ

config CONFIG_BUS_SPEED_176MHZ
	bool "176 MHz"
	depends on SUPPORT_BUS_SPEED_176MHZ && CONFIG_CPU_CLK_528MHZ

config CONFIG_BUS_SPEED_200MHZ
	bool "200 MHz"
	depends on SUPPORT_BUS_SPEED_200MHZ && CONFIG_CPU_CLK_600MHZ

endchoice

config SUPPORT_BUS_SPEED_83MHZ
	bool

config SUPPORT_BUS_SPEED_90MHZ
	bool

config SUPPORT_BUS_SPEED_100MHZ
	bool

config SUPPORT_BUS_SPEED_116MHZ
	bool

config SUPPORT_BUS_SPEED_124MHZ
	bool

config SUPPORT_BUS_SPEED_133MHZ
	bool

config SUPPORT_BUS_SPEED_148MHZ
	bool

config SUPPORT_BUS_SPEED_164MHZ
	bool

config SUPPORT_BUS_SPEED_166MHZ
	bool

config SUPPORT_BUS_SPEED_170MHZ
	bool

config SUPPORT_BUS_SPEED_176MHZ
	bool

config SUPPORT_BUS_SPEED_200MHZ
	bool

config CPU_HAS_TRUSTZONE
	bool
	default n

config CONFIG_CPU_V7
	bool
	default n

config CONFIG_HAS_PMIC_ACT8865
	bool
	default n

config CONFIG_SUPPORT_PM
	bool
	default n

config CONFIG_HAS_ONE_WIRE
	bool
	default n

config CONFIG_HAS_EEPROM
	bool
	default n

config CONFIG_HAS_EHT0_PHY
	bool
	default n

config CONFIG_HAS_EHT1_PHY
	bool
	default n

config CONFIG_HAS_AUDIO_CODEC
	bool
	default n

config CONFIG_HAS_HDMI
	bool
	default n

config CORE_ARM926EJS
	bool
	default n

config CORE_CORTEX_A5
	bool
	default n

config CPU_HAS_SCKC
	bool
	default n

config CPU_HAS_H32MXDIV
	bool
	default n

config CPU_HAS_HSMCI0
	bool
	default n

config CPU_HAS_HSMCI1
	bool
	default n

config CPU_HAS_HSMCI2
	bool
	default n

config CPU_HAS_MCI0
	bool
	default n

config CPU_HAS_MCI1
	bool
	default n

config CPU_HAS_SDHC0
	bool
	default n

config CPU_HAS_SDHC1
	bool
	default n

config CPU_HAS_SPI0
	bool
	default n

config CPU_HAS_SPI1
	bool
	default n

config CPU_HAS_SPI0_IOSET1
	bool
	default n

config CPU_HAS_SPI0_IOSET2
	bool
	default n

config CPU_HAS_SPI1_IOSET1
	bool
	default n

config CPU_HAS_SPI1_IOSET2
	bool
	default n

config CPU_HAS_SPI1_IOSET3
	bool
	default n

config CPU_HAS_QSPI0
	bool
	default n

config CPU_HAS_QSPI1
	bool
	default n

config CPU_HAS_QSPI0_IOSET1
	bool
	default n

config CPU_HAS_QSPI0_IOSET2
	bool
	default n

config CPU_HAS_QSPI0_IOSET3
	bool
	default n

config CPU_HAS_QSPI1_IOSET1
	bool
	default n

config CPU_HAS_QSPI1_IOSET2
	bool
	default n

config CPU_HAS_QSPI1_IOSET3
	bool
	default n

config BOARD_HAS_2_BANKS
	bool
	default n
```

## board/at91sam9m10g45ek/at91sam9m10g45eknf_uboot_defconfig
```kconfig
CONFIG_AT91SAM9M10G45EK=y
CONFIG_NANDFLASH=y
CONFIG_DEBUG=y
CONFIG_THUMB=y
CONFIG_SCLK=y

CONFIG_IMG_ADDRESS="0x00060000"
CONFIG_IMG_SIZE="0x000A0000"
CONFIG_USER_HW_INIT=y
CONFIG_RAM_128MB=y

# CONFIG_NANDFLASH_RECOVERY is not set
```

## board/at91sam9n12ek/at91sam9n12ekdf_linux_image_dt_defconfig
```kconfig
CONFIG_AT91SAM9N12EK=y
CONFIG_LOAD_LINUX=y
CONFIG_MEM_SIZE="0x8000000"
CONFIG_DEBUG=y
CONFIG_THUMB=y
CONFIG_SCLK=y
```

## board/at91sam9x5ek/at91sam9x5eksd_linux_zimage_dt_defconfig
```kconfig
CONFIG_AT91SAM9X5EK=y
CONFIG_RAM_128MB=y
CONFIG_SDCARD=y
CONFIG_LOAD_LINUX=y
CONFIG_LINUX_ZIMAGE=y
CONFIG_DEBUG=y
CONFIG_THUMB=y
CONFIG_SCLK=y
```

## board/at91sam9x5ek/at91sam9x5eksd_uboot_defconfig
```kconfig
CONFIG_AT91SAM9X5EK=y
CONFIG_RAM_128MB=y
CONFIG_SDCARD=y
CONFIG_DEBUG=y
CONFIG_THUMB=y
CONFIG_SCLK=y
```

## board/at91sam9x60ek/at91sam9x60eksd_uboot_defconfig
```kconfig
CONFIG_AT91SAM9X60EK=y
CONFIG_RAM_256MB=y
CONFIG_SDCARD=y
CONFIG_DEBUG=y
CONFIG_THUMB=y
# CONFIG_LOAD_EEPROM is not set
```

## board/sam9x60_ddr2_sip_eb/sam9x60_ddr2_sip_eb_bkptnone_defconfig
```kconfig
CONFIG_SAM9X60_DDR2_SIP_EB=y
CONFIG_RAM_128MB=y
CONFIG_LOAD_NONE=y
CONFIG_BKPT_NOTIFY_DONE=y
CONFIG_DEBUG=y
```

## board/sam9x60_sdr_sip_eb/sam9x60_sdr_sip_eb_bkptnone_defconfig
```kconfig
CONFIG_SAM9X60_SDR_SIP_EB=y
CONFIG_RAM_8MB=y
CONFIG_LOAD_NONE=y
CONFIG_BKPT_NOTIFY_DONE=y
CONFIG_DEBUG=y
```

## board/sam9x60ek/sam9x60ek_bkptnone_defconfig
```kconfig
CONFIG_SAM9X60EK=y
CONFIG_RAM_256MB=y
CONFIG_LOAD_NONE=y
CONFIG_BKPT_NOTIFY_DONE=y
CONFIG_DEBUG=y
```
