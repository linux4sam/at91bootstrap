## contrib/board/acme/at91sam9x5_arietta/arietta-128m_defconfig
```kconfig
HAVE_DOT_CONFIG=y
# CONFIG_AT91SAM9260EK is not set
# CONFIG_AT91SAM9261EK is not set
# CONFIG_AT91SAM9263EK is not set
# CONFIG_AT91SAM9RLEK is not set
# CONFIG_AT91SAM9XEEK is not set
# CONFIG_AT91SAM9G10EK is not set
# CONFIG_AT91SAM9G20EK is not set
# CONFIG_AT91SAM9M10G45EK is not set
# CONFIG_AT91SAM9X5EK is not set
# CONFIG_AT91SAM9N12EK is not set
# CONFIG_SAMA5D3XEK is not set
# CONFIG_SAMA5D3_XPLAINED is not set
# CONFIG_SAMA5D4EK is not set
# CONFIG_SAMA5D3_ACQUA is not set
CONFIG_AT91SAM9X5_ARIETTA=y
CONFIG_BOARDNAME="at91sam9x5_arietta"
AT91SAM9X5=y
CONFIG_MACH_TYPE="3373"
CONFIG_LINK_ADDR="0x300000"
CONFIG_TOP_OF_MEMORY="0x308000"
CONFIG_CRYSTAL_12_000MHZ=y
# CONFIG_CRYSTAL_16_000MHZ is not set
# CONFIG_CRYSTAL_16_36766MHZ is not set
# CONFIG_CRYSTAL_18_432MHZ is not set
ALLOW_CRYSTAL_12_000MHZ=y
CONFIG_CRYSTAL="CRYSTAL_12_000MHZ"
# CONFIG_CPU_CLK_166MHZ is not set
# CONFIG_CPU_CLK_180MHZ is not set
# CONFIG_CPU_CLK_200MHZ is not set
# CONFIG_CPU_CLK_240MHZ is not set
# CONFIG_CPU_CLK_266MHZ is not set
# CONFIG_CPU_CLK_332MHZ is not set
# CONFIG_CPU_CLK_396MHZ is not set
CONFIG_CPU_CLK_400MHZ=y
# CONFIG_CPU_CLK_498MHZ is not set
# CONFIG_CPU_CLK_510MHZ is not set
# CONFIG_CPU_CLK_528MHZ is not set
ALLOW_CPU_CLK_400MHZ=y
# DISABLE_CPU_CLK_240MHZ is not set
# CONFIG_BUS_SPEED_83MHZ is not set
# CONFIG_BUS_SPEED_90MHZ is not set
CONFIG_BUS_SPEED_100MHZ=y
# CONFIG_BUS_SPEED_133MHZ is not set
# CONFIG_BUS_SPEED_166MHZ is not set
# CONFIG_BUS_SPEED_170MHZ is not set
# CONFIG_BUS_SPEED_176MHZ is not set
# CONFIG_TRUSTZONE is not set
# CONFIG_CPU_V7 is not set
# CONFIG_HAS_PMIC_ACT8865 is not set
# CONFIG_PM is not set
#ALLOW_PIO3=y
#CONFIG_HAS_PIO3=y
#CPU_HAS_PMECC=y
# CONFIG_LOAD_ONE_WIRE is not set
# CONFIG_MMC_SUPPORT is not set
# CONFIG_TWI is not set
# CONFIG_MACB is not set

#
# Memory selection
#
# CONFIG_SDRAM is not set
# CONFIG_SDDRC is not set
CONFIG_DDRC=y
# ALLOW_DATAFLASH is not set
# ALLOW_FLASH is not set
# ALLOW_NANDFLASH is not set
ALLOW_SDCARD=y
ALLOW_HSMCI=y
# ALLOW_PSRAM is not set
# ALLOW_SDRAM_16BIT is not set

#
# RAM Configuration
#
# CONFIG_RAM_32MB is not set
# CONFIG_RAM_64MB is not set
CONFIG_RAM_128MB=y
# CONFIG_RAM_256MB is not set
# CONFIG_RAM_512MB is not set
# CONFIG_LPDDR2 is not set
CONFIG_DDR2=y
# CONFIG_DATAFLASH is not set
# CONFIG_FLASH is not set
# CONFIG_NANDFLASH is not set
CONFIG_SDCARD=y
CONFIG_MEMORY="sdcard"

#
# SD Card Configuration
#
CONFIG_SDCARD_HS=y
CONFIG_FATFS=y
CONFIG_LONG_FILENAME=y
#ALLOW_DATAFLASH_RECOVERY=y
#ALLOW_BOOT_FROM_DATAFLASH_CS0=y
#ALLOW_NANDFLASH_RECOVERY=y
CONFIG_BOOTSTRAP_MAXSIZE="23000"
CONFIG_PROJECT="sdcard"
# CONFIG_LOAD_UBOOT is not set
CONFIG_LOAD_LINUX=y
# CONFIG_LOAD_ANDROID is not set
# CONFIG_LOAD_1MB is not set
# CONFIG_LOAD_4MB is not set
# CONFIG_LOAD_64KB is not set
# CONFIG_LINUX_UIMAGE is not set
CONFIG_LINUX_ZIMAGE=y

#
# Linux Image Storage Setup
#
CONFIG_MEM_BANK="0x20000000"
CONFIG_MEM_SIZE="0x8000000"
CONFIG_JUMP_ADDR="0x22000000"
CONFIG_OF_LIBFDT=y
CONFIG_OF_ADDRESS="0x21000000"
CONFIG_IMAGE_NAME="zImage"
CONFIG_DEBUG=y
CONFIG_DEBUG_INFO=y
# CONFIG_DEBUG_LOUD is not set
# CONFIG_DEBUG_VERY_LOUD is not set
CONFIG_THUMB=y
CONFIG_DISABLE_WATCHDOG=y

#
# Hardware Initialization Options
#
CONFIG_HW_INIT=y
# CONFIG_USER_HW_INIT is not set

#
# Slow Clock Configuration Options
#
# CONFIG_SCLK is not set

#
# Board's Workaround Options
#
```

## contrib/board/acme/sama5d3_acqua/acqua-dt_defconfig
```kconfig
HAVE_DOT_CONFIG=y
CONFIG_SAMA5D3_ACQUA=y
CONFIG_BOARDNAME="sama5d3_acqua"
SAMA5D3X=y
CONFIG_MACH_TYPE="9999"
CONFIG_LINK_ADDR="0x300000"
CONFIG_TOP_OF_MEMORY="0x310000"
CONFIG_CRYSTAL_12_000MHZ=y
ALLOW_CRYSTAL_12_000MHZ=y
CONFIG_CRYSTAL="CRYSTAL_12_000MHZ"
CONFIG_CPU_CLK_528MHZ=y
ALLOW_CPU_CLK_266MHZ=y
ALLOW_CPU_CLK_332MHZ=y
ALLOW_CPU_CLK_396MHZ=y
ALLOW_CPU_CLK_498MHZ=y
ALLOW_CPU_CLK_528MHZ=y
CONFIG_BUS_SPEED_133MHZ=y
CONFIG_HAS_PMIC_ACT8865=y
CONFIG_PM=y
ALLOW_PIO3=y
CONFIG_HAS_PIO3=y
CPU_HAS_PMECC=y
CONFIG_MMC_SUPPORT=y

#
# Memory selection
#
CONFIG_DDRC=y
ALLOW_NANDFLASH=y
ALLOW_SDCARD=y
ALLOW_HSMCI=y

#
# RAM Configuration
#
CONFIG_DDR2=y
CONFIG_SDCARD=y
CONFIG_MEMORY="sdcard"

#
# SD Card Configuration
#
CONFIG_SDCARD_HS=y
CONFIG_FATFS=y
CONFIG_LONG_FILENAME=y
CONFIG_BOOTSTRAP_MAXSIZE="65536"
CONFIG_PROJECT="sdcard"
CONFIG_LOAD_LINUX=y
CONFIG_LINUX_ZIMAGE=y

#
# Linux Image Storage Setup
#
CONFIG_MEM_BANK="0"
CONFIG_MEM_SIZE="0"
CONFIG_LINUX_KERNEL_ARG_STRING=""
CONFIG_JUMP_ADDR="0x22000000"
CONFIG_OF_LIBFDT=y
CONFIG_OF_ADDRESS="0x21000000"
CONFIG_IMAGE_NAME="zImage"
CONFIG_DEBUG=y
CONFIG_DEBUG_INFO=y
CONFIG_DISABLE_WATCHDOG=y

#
# Hardware Initialization Options
#
CONFIG_HW_INIT=y

#
# Slow Clock Configuration Options
#
CONFIG_SCLK=y
```

## contrib/board/corewind/core9g25/core9g25-128m-nf_defconfig
```kconfig
CONFIG_CORE9G25=y
CONFIG_RAM_128MB=y
CONFIG_NANDFLASH=y
ALLOW_NANDFLASH_RECOVERY=y
CONFIG_NANDFLASH_RECOVERY=y
CONFIG_DEBUG=y
CONFIG_THUMB=y
# CONFIG_SCLK is not set
# CONFIG_LOAD_ONE_WIRE is not set
```

## contrib/board/vd-rd/glasnost_m9g10/glasnost_m9g10sd_uboot_defconfig
```kconfig
CONFIG_GLASNOST_M9G10=y
CONFIG_LONG_FILENAME=n
CONFIG_SDCARD=y
CONFIG_RAM_64MB=y
CONFIG_THUMB=y
CONFIG_DISABLE_WATCHDOG=n
```
