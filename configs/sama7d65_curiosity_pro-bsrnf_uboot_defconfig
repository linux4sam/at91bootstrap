## configs/sama7d65_curiosity_pro-bsrnf_uboot_defconfig
```kconfig
# Copyright (C) 2025 Microchip Technology Inc. and its subsidiaries
#
# SPDX-License-Identifier: MIT

CONFIG_SAMA7D65=y
CONFIG_CPU_CLK_800MHZ=y
CONFIG_DEBUG=y
CONFIG_CONSOLE_INDEX=19
CONFIG_DDR_SET_BY_DEVICE=y
CONFIG_DDR_W638GU6RB11=y
CONFIG_DDR_8_GBIT=y
CONFIG_MEM_CLOCK_533=y
CONFIG_NANDFLASH=y
CONFIG_JUMP_ADDR="0x66f00000"
CONFIG_IMG_SIZE="0x000d0000"
# CONFIG_REDIRECT_ALL_INTS_AIC is not set
CONFIG_TZC400=y
CONFIG_BACKUP_MODE=y
CONFIG_MCP16502=y
CONFIG_MCP16502_SET_VOLTAGE=y
CONFIG_PMIC_ON_TWI=0
CONFIG_VOLTAGE_OUT4=1150
CONFIG_LED_ON_BOARD=y
CONFIG_LED_R_ON_PIOA=y
CONFIG_LED_R_PIN=21
CONFIG_LED_G_ON_PIOB=y
CONFIG_LED_G_PIN=15
CONFIG_LED_B_ON_PIOB=y
CONFIG_LED_B_PIN=17
CONFIG_FLEXCOM10=y
CONFIG_FLEXCOM10_IOSET=1
CONFIG_WDTS=y
CONFIG_SHDWC=y
```

## configs/sama7d65_curiositysd1_fb_uboot_defconfig
```kconfig
# Copyright (C) 2006 Microchip Technology Inc. and its subsidiaries
#
# SPDX-License-Identifier: MIT

CONFIG_SAMA7D65=y
CONFIG_CPU_CLK_800MHZ=y
CONFIG_DEBUG=y
CONFIG_CONSOLE_INDEX=19
CONFIG_DDR_SET_BY_DEVICE=y
CONFIG_DDR_AS4C512M16D3LA_10BIN=y
CONFIG_DDR_8_GBIT=y
CONFIG_MEM_CLOCK_533=y
CONFIG_SDCARD=y
CONFIG_SDHC1=y
CONFIG_SDHC_18V=y
CONFIG_SDHC_UHS=y
CONFIG_SDHC_CLK_100MHZ=y
CONFIG_SDHC_SD_DDR200=y
CONFIG_JUMP_ADDR="0x66f00000"
# CONFIG_REDIRECT_ALL_INTS_AIC is not set
CONFIG_TZC400=y
CONFIG_MCP16502=y
CONFIG_MCP16502_SET_VOLTAGE=y
CONFIG_BACKUP_MODE=y
CONFIG_FAST_BOOT=y
CONFIG_FASTBOOT_MEM_MAP_ADDRESS=0xC0000000
CONFIG_FASTBOOT_MAX_NB_MEM_MAP=0x40000
CONFIG_FASTBOOT_SIZEOF_PAGE_STRU=0x20
CONFIG_FASTBOOT_OFFSET_OF_PAGETYPE=0x18
CONFIG_FASTBOOT_OFFSET_OF_PRIVATE=0x14
CONFIG_FASTBOOT_SD_PARTITION=3
CONFIG_SHDWC=y
CONFIG_PMIC_ON_TWI=0
CONFIG_VOLTAGE_OUT4=1150
CONFIG_LED_ON_BOARD=y
CONFIG_LED_R_ON_PIOA=y
CONFIG_LED_R_PIN=21
CONFIG_LED_G_ON_PIOB=y
CONFIG_LED_G_PIN=15
CONFIG_LED_B_ON_PIOB=y
CONFIG_LED_B_PIN=17
CONFIG_FLEXCOM10=y
CONFIG_FLEXCOM10_IOSET=1
CONFIG_WDTS=y
```

## configs/sama7d65_som4g_nf_uboot_defconfig
```kconfig
# Copyright (C) 2025 Microchip Technology Inc. and its subsidiaries
#
# SPDX-License-Identifier: MIT

CONFIG_SAMA7D65=y
CONFIG_CPU_CLK_800MHZ=y
CONFIG_DEBUG=y
CONFIG_CONSOLE_INDEX=19
CONFIG_DDR_SET_BY_DEVICE=y
CONFIG_DDR_W634GU6NB12I=y
CONFIG_MEM_CLOCK_533=y
CONFIG_NANDFLASH=y
# CONFIG_REDIRECT_ALL_INTS_AIC is not set
CONFIG_TZC400=y
CONFIG_JUMP_ADDR="0x66f00000"
```

## configs/sama7d65_som512m_qspi_uboot_defconfig
```kconfig
# Copyright (C) 2025 Microchip Technology Inc. and its subsidiaries
#
# SPDX-License-Identifier: MIT
CONFIG_SAMA7D65=y
CONFIG_CPU_CLK_800MHZ=y
CONFIG_DEBUG=y
CONFIG_CONSOLE_INDEX=19
CONFIG_DDR_SET_BY_DEVICE=y
CONFIG_DDR_W9751G6NB=y
CONFIG_MEM_CLOCK_533=y
CONFIG_SPI_CLK=50000000
CONFIG_QSPI=y
# CONFIG_REDIRECT_ALL_INTS_AIC is not set
CONFIG_TZC400=y
CONFIG_JUMP_ADDR="0x60100000"
```

## configs/sama7g54_curiositydf_qspi_uboot_defconfig
```kconfig
# Copyright (C) 2024 Microchip Technology Inc. and its subsidiaries
#
# SPDX-License-Identifier: MIT

CONFIG_SAMA7G5=y
CONFIG_CPU_CLK_800MHZ=y
CONFIG_DEBUG=y
CONFIG_DDR_SET_BY_DEVICE=y
CONFIG_DDR_W632GU6NB12I=y
CONFIG_MEM_CLOCK_533=y
CONFIG_SPI_CLK=100000000
CONFIG_QSPI_BUS=1
CONFIG_QSPI_DMA_SUPPORT=y
CONFIG_IMG_ADDRESS="0x00040000"
CONFIG_JUMP_ADDR="0x66f00000"
CONFIG_IMG_SIZE="0x00100000"
# CONFIG_REDIRECT_ALL_INTS_AIC is not set
CONFIG_TZC400=y
CONFIG_LED_ON_BOARD=y
CONFIG_LED_R_ON_PIOD=y
CONFIG_LED_R_PIN=13
CONFIG_LED_G_ON_PIOD=y
CONFIG_LED_G_PIN=14
CONFIG_LED_B_ON_PIOB=y
CONFIG_LED_B_PIN=15
CONFIG_FLEXCOM10=y
CONFIG_FLEXCOM10_IOSET=2
CONFIG_MCP16502=y
CONFIG_MCP16502_SET_VOLTAGE=y
CONFIG_VOLTAGE_OUT1=3300
CONFIG_VOLTAGE_OUT2=1350
CONFIG_VOLTAGE_OUT3=1150
CONFIG_VOLTAGE_OUT4=1150
CONFIG_VOLTAGE_LDO1=1800
CONFIG_VOLTAGE_LDO2=1800
CONFIG_WDTS=y
```

## configs/sama7g54_curiositysd_uboot_defconfig
```kconfig
# Copyright (C) 2024 Microchip Technology Inc. and its subsidiaries
#
# SPDX-License-Identifier: MIT

CONFIG_SAMA7G5=y
CONFIG_CPU_CLK_800MHZ=y
CONFIG_DEBUG=y
CONFIG_DDR_SET_BY_DEVICE=y
CONFIG_DDR_W632GU6NB12I=y
CONFIG_MEM_CLOCK_533=y
CONFIG_SDCARD=y
CONFIG_SDHC1=y
CONFIG_JUMP_ADDR="0x66f00000"
# CONFIG_REDIRECT_ALL_INTS_AIC is not set
CONFIG_TZC400=y
CONFIG_LED_ON_BOARD=y
CONFIG_LED_R_ON_PIOD=y
CONFIG_LED_R_PIN=13
CONFIG_LED_G_ON_PIOD=y
CONFIG_LED_G_PIN=14
CONFIG_LED_B_ON_PIOB=y
CONFIG_LED_B_PIN=15
CONFIG_FLEXCOM10=y
CONFIG_FLEXCOM10_IOSET=2
CONFIG_MCP16502=y
CONFIG_MCP16502_SET_VOLTAGE=y
CONFIG_VOLTAGE_OUT1=3300
CONFIG_VOLTAGE_OUT2=1350
CONFIG_VOLTAGE_OUT3=1150
CONFIG_VOLTAGE_OUT4=1150
CONFIG_VOLTAGE_LDO1=1800
CONFIG_VOLTAGE_LDO2=1800
CONFIG_WDTS=y
```

## configs/sama7g54_som1g_nf_uboot_defconfig
```kconfig
# Copyright (C) 2025 Microchip Technology Inc. and its subsidiaries
#
# SPDX-License-Identifier: MIT

CONFIG_SAMA7G5=y
CONFIG_CPU_CLK_800MHZ=y
CONFIG_DEBUG=y
CONFIG_DDR_SET_BY_DEVICE=y
CONFIG_DDR_W631GU6NB12I=y
CONFIG_MEM_CLOCK_533=y
CONFIG_NANDFLASH=y
CONFIG_JUMP_ADDR="0x66f00000"
# CONFIG_REDIRECT_ALL_INTS_AIC is not set
CONFIG_TZC400=y
CONFIG_FLEXCOM1=y
CONFIG_FLEXCOM1_IOSET=4
CONFIG_MCP16502=y
CONFIG_MCP16502_SET_VOLTAGE=y
CONFIG_VOLTAGE_OUT4=1150
CONFIG_WDTS=y
```

## configs/sama7g5_ddr2_ebsd_uboot_defconfig
```kconfig
CONFIG_SAMA7G5=y
CONFIG_CPU_CLK_1000MHZ=y
CONFIG_RAM_512MB=y
CONFIG_SDCARD=y
CONFIG_SDHC1=y
CONFIG_JUMP_ADDR="0x66f00000"
CONFIG_DEBUG=y
# CONFIG_MATRIX is not set
# CONFIG_ENTER_NWD is not set
# CONFIG_REDIRECT_ALL_INTS_AIC is not set
CONFIG_TZC400=y
CONFIG_FLEXCOM1=y
CONFIG_FLEXCOM1_IOSET=4
CONFIG_MCP16502=y
CONFIG_PMIC_ON_TWI=0
CONFIG_WDTS=y
CONFIG_DDR_2_GBIT=y
CONFIG_DDR_SET_BY_DEVICE=y
CONFIG_DDR_MT47H128M16RT_25E_C=y
CONFIG_MEM_CLOCK_400=y
```

## configs/sama7g5_ddr3_ebdf_qspi_uboot_defconfig
```kconfig
# Copyright (C) 2006 Microchip Technology Inc. and its subsidiaries
#
# SPDX-License-Identifier: MIT

CONFIG_SAMA7G5=y
CONFIG_CPU_CLK_800MHZ=y
CONFIG_DEBUG=y
CONFIG_DDR_8_GBIT=y
CONFIG_DDR_SET_BY_DEVICE=y
CONFIG_DDR_MT41K512M16HA_125=y
CONFIG_MEM_CLOCK_533=y
CONFIG_SPI_CLK=100000000
CONFIG_AT91_QSPI_OCTAL=y
CONFIG_QSPI_4B_OPCODES=y
CONFIG_IMG_ADDRESS="0x00040000"
CONFIG_IMG_SIZE="0x000c0000"
CONFIG_JUMP_ADDR="0x66f00000"
# CONFIG_REDIRECT_ALL_INTS_AIC is not set
CONFIG_TZC400=y
CONFIG_FLEXCOM1=y
CONFIG_FLEXCOM1_IOSET=4
CONFIG_WDTS=y
```

## configs/sama7g5_ddr3_ebemmc_uboot_defconfig
```kconfig
CONFIG_SAMA7G5=y
CONFIG_CPU_CLK_1000MHZ=y
CONFIG_RAM_512MB=y
CONFIG_SDCARD=y
CONFIG_JUMP_ADDR="0x66f00000"
CONFIG_DEBUG=y
# CONFIG_MATRIX is not set
# CONFIG_ENTER_NWD is not set
# CONFIG_REDIRECT_ALL_INTS_AIC is not set
CONFIG_TZC400=y
CONFIG_FLEXCOM1=y
CONFIG_FLEXCOM1_IOSET=3
CONFIG_MCP16502=y
CONFIG_WDTS=y
CONFIG_DDR_4_GBIT=y
CONFIG_DDR_SET_BY_DEVICE=y
CONFIG_DDR_MT41K256M16TW_107=y
CONFIG_MEM_CLOCK_533=y
```

## configs/sama7g5_ddr3_ebsd_uboot_defconfig
```kconfig
# Copyright (C) 2006 Microchip Technology Inc. and its subsidiaries
#
# SPDX-License-Identifier: MIT

CONFIG_SAMA7G5=y
CONFIG_CPU_CLK_800MHZ=y
CONFIG_SDCARD=y
CONFIG_SDHC1=y
CONFIG_JUMP_ADDR="0x66f00000"
CONFIG_DEBUG=y
# CONFIG_ENTER_NWD is not set
# CONFIG_REDIRECT_ALL_INTS_AIC is not set
CONFIG_TZC400=y
CONFIG_FLEXCOM1=y
CONFIG_FLEXCOM1_IOSET=4
CONFIG_MCP16502=y
CONFIG_MCP16502_SET_VOLTAGE=y
CONFIG_PMIC_ON_TWI=0
CONFIG_VOLTAGE_OUT4=1150
CONFIG_WDTS=y
CONFIG_DDR_8_GBIT=y
CONFIG_DDR_SET_BY_DEVICE=y
CONFIG_DDR_MT41K512M16HA_125=y
CONFIG_MEM_CLOCK_533=y
```

## configs/sama7g5_lpddr2_ebnf_uboot_defconfig
```kconfig
# Copyright (C) 2022 Microchip Technology Inc. and its subsidiaries
#
# SPDX-License-Identifier: MIT

CONFIG_SAMA7G5=y
CONFIG_CPU_CLK_800MHZ=y
CONFIG_DEBUG=y
CONFIG_DDR_SET_BY_DEVICE=y
CONFIG_DDR_IS43LD16128B_25BLI=y
CONFIG_NANDFLASH=y
CONFIG_JUMP_ADDR="0x66f00000"
# CONFIG_REDIRECT_ALL_INTS_AIC is not set
CONFIG_TZC400=y
CONFIG_FLEXCOM1=y
CONFIG_FLEXCOM1_IOSET=4
CONFIG_WDTS=y
```

## configs/sama7g5_lpddr2_ebsd_uboot_defconfig
```kconfig
# Copyright (C) 2006 Microchip Technology Inc. and its subsidiaries
#
# SPDX-License-Identifier: MIT

CONFIG_SAMA7G5=y
CONFIG_CPU_CLK_800MHZ=y
CONFIG_SDCARD=y
CONFIG_SDHC1=y
CONFIG_JUMP_ADDR="0x66f00000"
CONFIG_DEBUG=y
# CONFIG_ENTER_NWD is not set
# CONFIG_REDIRECT_ALL_INTS_AIC is not set
CONFIG_TZC400=y
CONFIG_FLEXCOM1=y
CONFIG_FLEXCOM1_IOSET=4
CONFIG_WDTS=y
CONFIG_DDR_2_GBIT=y
CONFIG_DDR_SET_BY_DEVICE=y
CONFIG_LPDDR2_S4=y
CONFIG_DDR_IS43LD16128B_25BLI=y
```

## configs/sama7g5_lpddr3_ebnf_uboot_defconfig
```kconfig
# Copyright (C) 2022 Microchip Technology Inc. and its subsidiaries
#
# SPDX-License-Identifier: MIT

CONFIG_SAMA7G5=y
CONFIG_CPU_CLK_800MHZ=y
CONFIG_DEBUG=y
CONFIG_DDR_SET_BY_DEVICE=y
CONFIG_DDR_MT52L256M32D1PF_107=y
CONFIG_MEM_CLOCK_533=y
CONFIG_NANDFLASH=y
CONFIG_JUMP_ADDR="0x66f00000"
# CONFIG_REDIRECT_ALL_INTS_AIC is not set
CONFIG_TZC400=y
CONFIG_FLEXCOM1=y
CONFIG_FLEXCOM1_IOSET=4
CONFIG_WDTS=y
```

## configs/sama7g5ek-opteesd_uboot_defconfig
```kconfig
# Copyright (C) 2006 Microchip Technology Inc. and its subsidiaries
#
# SPDX-License-Identifier: MIT

CONFIG_SAMA7G5=y
CONFIG_CPU_CLK_800MHZ=y
CONFIG_DEBUG=y
CONFIG_DDR_SET_BY_DEVICE=y
CONFIG_DDR_AS4C256M16D3LC_12BCNTR=y
CONFIG_MEM_CLOCK_533=y
CONFIG_SDCARD=y
CONFIG_SDHC1=y
CONFIG_JUMP_ADDR="0x66f00000"
CONFIG_LOAD_OPTEE=y
CONFIG_OPTEE_JUMP_ADDR=0x60000000
# CONFIG_REDIRECT_ALL_INTS_AIC is not set
CONFIG_TZC400=y
CONFIG_BOARD_QUIRK_SAMA7G5_EK=y
CONFIG_LED_ON_BOARD=y
CONFIG_LED_R_ON_PIOB=y
CONFIG_LED_R_PIN=8
CONFIG_LED_G_ON_PIOA=y
CONFIG_LED_G_PIN=13
CONFIG_LED_B_ON_PIOD=y
CONFIG_LED_B_PIN=20
CONFIG_FLEXCOM1=y
CONFIG_FLEXCOM1_IOSET=4
CONFIG_MCP16502=y
CONFIG_MCP16502_SET_VOLTAGE=y
CONFIG_VOLTAGE_OUT1=3300
CONFIG_VOLTAGE_OUT2=1350
CONFIG_VOLTAGE_OUT3=1150
CONFIG_VOLTAGE_OUT4=1150
CONFIG_VOLTAGE_LDO1=1800
CONFIG_VOLTAGE_LDO2=1800
CONFIG_WDTS=y
```

## configs/sama7g5ekdf_qspi_fb_uboot_defconfig
```kconfig
# Copyright (C) 2021 Microchip Technology Inc. and its subsidiaries
#
# SPDX-License-Identifier: MIT

CONFIG_SAMA7G5=y
CONFIG_CPU_CLK_800MHZ=y
CONFIG_DEBUG=y
CONFIG_DDR_SET_BY_DEVICE=y
CONFIG_DDR_AS4C256M16D3LC_12BCNTR=y
CONFIG_MEM_CLOCK_533=y
CONFIG_SPI_CLK=133333334
CONFIG_AT91_QSPI_OCTAL=y
CONFIG_QSPI_4B_OPCODES=y
CONFIG_QSPI_OCTAL_IO=y
CONFIG_QSPI_DTR_ENABLE=y
CONFIG_QSPI_DMA_SUPPORT=y
CONFIG_IMG_ADDRESS="0x00040000"
CONFIG_JUMP_ADDR="0x66f00000"
CONFIG_IMG_SIZE="0x000c0000"
# CONFIG_REDIRECT_ALL_INTS_AIC is not set
CONFIG_TZC400=y
CONFIG_BACKUP_MODE=y
CONFIG_SHDWC=y
CONFIG_FAST_BOOT=y
CONFIG_FASTBOOT_MEM_MAP_ADDRESS=0xC0000000
CONFIG_FASTBOOT_MAX_NB_MEM_MAP=0x20000
CONFIG_FASTBOOT_SIZEOF_PAGE_STRUCT=0x20
CONFIG_FASTBOOT_OFFSET_OF_PAGETYPE=0x18
CONFIG_FASTBOOT_OFFSET_OF_PRIVATE=0x14
CONFIG_FASTBOOT_IMG_ADDRESS=0x00800000
CONFIG_LED_ON_BOARD=y
CONFIG_LED_R_ON_PIOB=y
CONFIG_LED_R_PIN=8
CONFIG_LED_G_ON_PIOA=y
CONFIG_LED_G_PIN=13
CONFIG_LED_B_ON_PIOD=y
CONFIG_LED_B_PIN=20
CONFIG_FLEXCOM1=y
CONFIG_FLEXCOM1_IOSET=4
CONFIG_MCP16502=y
CONFIG_MCP16502_SET_VOLTAGE=y
CONFIG_VOLTAGE_OUT1=3300
CONFIG_VOLTAGE_OUT2=1350
CONFIG_VOLTAGE_OUT3=1150
CONFIG_VOLTAGE_OUT4=1150
CONFIG_VOLTAGE_LDO1=1800
CONFIG_VOLTAGE_LDO2=1800
CONFIG_WDTS=y
```

## configs/sama7g5ekdf_qspi_uboot_defconfig
```kconfig
# Copyright (C) 2021 Microchip Technology Inc. and its subsidiaries
#
# SPDX-License-Identifier: MIT

CONFIG_SAMA7G5=y
CONFIG_CPU_CLK_1000MHZ=y
CONFIG_SPI_CLK=133000000
CONFIG_QSPI=y
CONFIG_QSPI_BUS=0
CONFIG_QSPI_IOSET=1
CONFIG_AT91_QSPI_OCTAL=y
CONFIG_QSPI_4B_OPCODES=y
CONFIG_IMG_ADDRESS="0x00040000"
CONFIG_IMG_SIZE="0x000c0000"
CONFIG_JUMP_ADDR="0x66f00000"
CONFIG_DEBUG=y
# CONFIG_ENTER_NWD is not set
# CONFIG_REDIRECT_ALL_INTS_AIC is not set
CONFIG_TZC400=y
CONFIG_FLEXCOM1=y
CONFIG_FLEXCOM1_IOSET=4
CONFIG_MCP16502=y
CONFIG_MCP16502_SET_VOLTAGE=y
CONFIG_PMIC_ON_TWI=0
CONFIG_VOLTAGE_OUT1=3300
CONFIG_VOLTAGE_OUT2=1350
CONFIG_VOLTAGE_OUT3=1150
CONFIG_VOLTAGE_OUT4=1250
CONFIG_VOLTAGE_LDO1=1800
CONFIG_VOLTAGE_LDO2=1800
CONFIG_WDTS=y
CONFIG_LED_ON_BOARD=y
CONFIG_LED_R_ON_PIOB=y
CONFIG_LED_R_PIN=8
CONFIG_LED_G_ON_PIOA=y
CONFIG_LED_G_PIN=13
CONFIG_LED_B_ON_PIOD=y
CONFIG_LED_B_PIN=20
CONFIG_DDR_4_GBIT=y
CONFIG_DDR_SET_BY_DEVICE=y
CONFIG_DDR_MT41K256M16TW_107=y
CONFIG_MEM_CLOCK_533=y
```

## configs/sama7g5ekemmc_uboot_defconfig
```kconfig
CONFIG_SAMA7G5=y
CONFIG_CPU_CLK_1000MHZ=y
CONFIG_RAM_512MB=y
CONFIG_SDCARD=y
CONFIG_JUMP_ADDR="0x66f00000"
CONFIG_DEBUG=y
# CONFIG_MATRIX is not set
# CONFIG_ENTER_NWD is not set
# CONFIG_REDIRECT_ALL_INTS_AIC is not set
CONFIG_TZC400=y
CONFIG_MCP16502=y
CONFIG_WDTS=y
CONFIG_DDR_512_MBIT=y
CONFIG_DDR_SET_BY_DEVICE=y
CONFIG_DDR_MT41K256M16TW_107=y
```

## contrib/board/acme/at91sam9g20_fox/at91sam9g20_foxsd_linux_image_defconfig
```kconfig
CONFIG_AT91SAM9G20_FOX=y
CONFIG_SDCARD=y
CONFIG_MCI_SLOTB=y
CONFIG_RAM_64MB=y
CONFIG_LOAD_LINUX=y
# CONFIG_OF_LIBFDT is not set
CONFIG_DEBUG=y
CONFIG_THUMB=y
```

## contrib/board/acme/at91sam9g20_fox/at91sam9g20_foxsd_linux_image_dt_defconfig
```kconfig
CONFIG_AT91SAM9G20_FOX=y
CONFIG_SDCARD=y
CONFIG_RAM_64MB=y
CONFIG_LOAD_LINUX=y
CONFIG_DEBUG=y
CONFIG_THUMB=y
```

## contrib/board/acme/at91sam9g20_fox/fox_defconfig
```kconfig
CONFIG_AT91SAM9G20_FOX=y
CONFIG_RAM_64MB=y
CONFIG_SDCARD=y
CONFIG_LOAD_LINUX=y
CONFIG_OVERRIDE_CMDLINE=y
CONFIG_IMAGE_NAME="zImage"
CONFIG_DEBUG=y
CONFIG_THUMB=y
# CONFIG_LOAD_ONE_WIRE is not set
```
