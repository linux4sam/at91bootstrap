## configs/sam9x60_curiositysd_fb_defconfig
```kconfig
CONFIG_SAM9X60=y
CONFIG_DEBUG=y
CONFIG_LOAD_HW_INFO=y
CONFIG_DDRC=y
CONFIG_DDR_SET_BY_DEVICE=y
CONFIG_DDR_W971GG6SB=y
CONFIG_SDCARD=y
CONFIG_THUMB=y
CONFIG_FAST_BOOT=y
# CONFIG_FASTBOOT_AUTO_MODE is not set
# CONFIG_FASTBOOT_MANUAL_MODE is not set
CONFIG_FASTBOOT_PRESAVED_MODE=y
# CONFIG_FASTBOOT_ZERO_PAGE is not set
CONFIG_FASTBOOT_SD_PARTITION=3
# CONFIG_FASTBOOT_CRC is not set
# CONFIG_FASTBOOT_DUMP is not set
CONFIG_BOARD_QUIRK_SAM9X60_CURIOSITY=y
CONFIG_LED_ON_BOARD=y
CONFIG_LED_R_ON_PIOD=y
CONFIG_LED_R_PIN=17
CONFIG_LED_G_ON_PIOD=y
CONFIG_LED_G_PIN=19
CONFIG_LED_B_ON_PIOD=y
CONFIG_LED_B_PIN=21
CONFIG_LOAD_EEPROM=y
CONFIG_EEPROM_ADDR=0x53
```

## configs/sama5d27_som1_eksd_fb_auto_defconfig
```kconfig
# Copyright (C) 2006 Microchip Technology Inc. and its subsidiaries
#
# SPDX-License-Identifier: MIT

CONFIG_SAMA5D2=y
CONFIG_CRYSTAL_24_000MHZ=y
CONFIG_DEBUG=y
CONFIG_DDR_SET_BY_DEVICE=y
CONFIG_DDR_W971GG6SB_D2=y
CONFIG_SDCARD=y
CONFIG_JUMP_ADDR="0x23f00000"
# CONFIG_ENTER_NWD is not set
# CONFIG_SDHC_8BIT_SUPPORT is not set
CONFIG_BACKUP_MODE=y
CONFIG_FAST_BOOT=y
CONFIG_FASTBOOT_AUTO_MODE=y
# CONFIG_FASTBOOT_MANUAL_MODE is not set
# CONFIG_FASTBOOT_PRESAVED_MODE is not set
# CONFIG_FASTBOOT_ZERO_PAGE is not set
CONFIG_FASTBOOT_SD_PARTITION=3
# CONFIG_FASTBOOT_CRC is not set
# CONFIG_FASTBOOT_DUMP is not set
CONFIG_BOARD_QUIRK_SAMA5D2_SIP=y
CONFIG_LED_ON_BOARD=y
CONFIG_LED_R_ON_PIOA=y
CONFIG_LED_R_PIN=10
CONFIG_LED_G_ON_PIOB=y
CONFIG_LED_G_PIN=1
CONFIG_LED_B_ON_PIOA=y
CONFIG_LED_B_PIN=31
```

## configs/sama5d2_ptc_eknf_uboot_defconfig
```kconfig
# Copyright (C) 2006 Microchip Technology Inc. and its subsidiaries
#
# SPDX-License-Identifier: MIT

CONFIG_SAMA5D2=y
CONFIG_CRYSTAL_24_000MHZ=y
CONFIG_CONSOLE_INDEX=0
CONFIG_DEBUG=y
CONFIG_DDR_SET_BY_DEVICE=y
CONFIG_DDR_W972GG6KB_D2=y
CONFIG_MMU=y
CONFIG_CACHES=y
CONFIG_NANDFLASH=y
CONFIG_NAND_TIMING_MODE=y
CONFIG_IMG_SIZE="0x000c0000"
```
