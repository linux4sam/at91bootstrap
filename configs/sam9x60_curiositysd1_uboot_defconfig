## configs/sam9x60_curiositysd1_uboot_defconfig
```kconfig
# Copyright (C) 2021 Microchip Technology Inc. and its subsidiaries
#
# SPDX-License-Identifier: MIT

CONFIG_SAM9X60=y
CONFIG_DEBUG=y
CONFIG_LOAD_HW_INFO=y
CONFIG_DDRC=y
CONFIG_DDR_SET_BY_DEVICE=y
CONFIG_DDR_W971GG6SB=y
CONFIG_SDCARD=y
CONFIG_SDHC1=y
CONFIG_THUMB=y
CONFIG_BOARD_QUIRK_SAM9X60_CURIOSITY=y
CONFIG_LED_ON_BOARD=y
CONFIG_LED_R_ON_PIOD=y
CONFIG_LED_R_PIN=17
CONFIG_LED_G_ON_PIOD=y
CONFIG_LED_G_PIN=19
CONFIG_LED_B_ON_PIOD=y
CONFIG_LED_B_PIN=21
CONFIG_LOAD_EEPROM=y
CONFIG_EEPROM_ADDR=0x53
```

## configs/sam9x60_ddr2_sip_eb_bkptnone_defconfig
```kconfig
CONFIG_INIT_AND_STOP=y
CONFIG_SAM9X60=y
CONFIG_RAM_128MB=y
CONFIG_DEBUG=y
CONFIG_CRYSTAL_24_000MHZ=y
CONFIG_DDRC=y
CONFIG_DDR_SET_BY_DEVICE=y
CONFIG_DDR_W971GG6SB=y
```

## configs/sam9x60_ddr2_sip_ebdf_qspi_linux_image_dt_defconfig
```kconfig
CONFIG_SAM9X60=y
CONFIG_RAM_128MB=y
CONFIG_SPI_CLK=50000000
CONFIG_QSPI=y
CONFIG_QSPI_BUS=0
CONFIG_OVERRIDE_CMDLINE=y
CONFIG_IMG_ADDRESS="0x00200000"
CONFIG_OF_OFFSET="0x00180000"
CONFIG_LOAD_LINUX=y
CONFIG_JUMP_ADDR="0x26F00000"
CONFIG_DEBUG=y
CONFIG_CRYSTAL_24_000MHZ=y
CONFIG_DDRC=y
CONFIG_DDR_SET_BY_DEVICE=y
CONFIG_DDR2_W971GG6SB=y
```

## configs/sam9x60_ddr2_sip_ebdf_qspi_uboot_defconfig
```kconfig
# Copyright (C) 2006 Microchip Technology Inc. and its subsidiaries
#
# SPDX-License-Identifier: MIT

CONFIG_SAM9X60=y
CONFIG_SPI_CLK=50000000
CONFIG_QSPI=y
CONFIG_QSPI_BUS=0
CONFIG_IMG_ADDRESS="0x00040000"
CONFIG_IMG_SIZE="0x000c0000"
CONFIG_DEBUG=y
CONFIG_CRYSTAL_24_000MHZ=y
CONFIG_DDRC=y
CONFIG_DDR_SET_BY_DEVICE=y
CONFIG_DDR_W971GG6SB=y
CONFIG_BOARD_QUIRK_SAM9X60_EB=y
CONFIG_LED_ON_BOARD=y
CONFIG_LED_R_ON_PIOB=y
CONFIG_LED_R_PIN=11
CONFIG_LED_G_ON_PIOB=y
CONFIG_LED_G_PIN=12
CONFIG_LED_B_ON_PIOB=y
CONFIG_LED_B_PIN=13
```

## configs/sam9x60_ddr2_sip_ebnf_uboot_defconfig
```kconfig
CONFIG_SAM9X60=y
CONFIG_RAM_128MB=y
CONFIG_NANDFLASH=y
# CONFIG_PMECC_AUTO_DETECT is not set
CONFIG_PMECC_CORRECT_BITS_8=y
CONFIG_IMG_SIZE="0x000c0000"
CONFIG_DEBUG=y
CONFIG_THUMB=y
CONFIG_CRYSTAL_24_000MHZ=y
CONFIG_DDRC=y
CONFIG_DDR_SET_BY_DEVICE=y
CONFIG_DDR_W971GG6SB=y
```

## configs/sam9x60_ddr2_sip_ebsd_uboot_defconfig
```kconfig
# Copyright (C) 2006 Microchip Technology Inc. and its subsidiaries
#
# SPDX-License-Identifier: MIT

CONFIG_SAM9X60=y
CONFIG_SDCARD=y
CONFIG_DEBUG=y
CONFIG_THUMB=y
CONFIG_CRYSTAL_24_000MHZ=y
CONFIG_DDRC=y
CONFIG_DDR_SET_BY_DEVICE=y
CONFIG_DDR_W971GG6SB=y
CONFIG_BOARD_QUIRK_SAM9X60_EB=y
CONFIG_LED_ON_BOARD=y
CONFIG_LED_R_ON_PIOB=y
CONFIG_LED_R_PIN=11
CONFIG_LED_G_ON_PIOB=y
CONFIG_LED_G_PIN=12
CONFIG_LED_B_ON_PIOB=y
CONFIG_LED_B_PIN=13
```

## configs/sam9x60_sdr_sip_eb_bkptnone_defconfig
```kconfig
# Copyright (C) 2006 Microchip Technology Inc. and its subsidiaries
#
# SPDX-License-Identifier: MIT

CONFIG_INIT_AND_STOP=y
CONFIG_SAM9X60=y
CONFIG_DEBUG=y
CONFIG_CRYSTAL_24_000MHZ=y
CONFIG_SDRAM=y
CONFIG_BOARD_QUIRK_SAM9X60_EB=y
CONFIG_LED_ON_BOARD=y
CONFIG_LED_R_ON_PIOB=y
CONFIG_LED_R_PIN=11
CONFIG_LED_G_ON_PIOB=y
CONFIG_LED_G_PIN=12
CONFIG_LED_B_ON_PIOB=y
CONFIG_LED_B_PIN=13
```

## configs/sam9x60_sdr_sip_ebdf_qspi_linux_image_dt_defconfig
```kconfig
# Copyright (C) 2006 Microchip Technology Inc. and its subsidiaries
#
# SPDX-License-Identifier: MIT

CONFIG_SAM9X60=y
CONFIG_SPI_CLK=50000000
CONFIG_QSPI=y
CONFIG_QSPI_BUS=0
CONFIG_OVERRIDE_CMDLINE=y
CONFIG_IMG_ADDRESS="0x00200000"
CONFIG_OF_OFFSET="0x00180000"
CONFIG_LOAD_LINUX=y
CONFIG_JUMP_ADDR="0x26F00000"
CONFIG_DEBUG=y
CONFIG_CRYSTAL_24_000MHZ=y
CONFIG_SDRAM=y
CONFIG_BOARD_QUIRK_SAM9X60_EB=y
CONFIG_LED_ON_BOARD=y
CONFIG_LED_R_ON_PIOB=y
CONFIG_LED_R_PIN=11
CONFIG_LED_G_ON_PIOB=y
CONFIG_LED_G_PIN=12
CONFIG_LED_B_ON_PIOB=y
CONFIG_LED_B_PIN=13
```

## configs/sam9x60_sdr_sip_ebdf_qspi_uboot_defconfig
```kconfig
CONFIG_SAM9X60=y
CONFIG_RAM_8MB=y
CONFIG_SDRAM_16BIT=y
CONFIG_SPI_CLK=50000000
CONFIG_QSPI=y
CONFIG_QSPI_BUS=0
CONFIG_IMG_ADDRESS="0x00040000"
CONFIG_IMG_SIZE="0x000c0000"
CONFIG_DEBUG=y
CONFIG_CRYSTAL_24_000MHZ=y
CONFIG_SDRAM=y
CONFIG_BOARD_QUIRK_SAM9X60=y
CONFIG_LED_ON_BOARD=y
CONFIG_LED_R_ON_PIOB=y
CONFIG_LED_R_PIN=11
CONFIG_LED_G_ON_PIOB=y
CONFIG_LED_G_PIN=12
CONFIG_LED_B_ON_PIOB=y
CONFIG_LED_B_PIN=13
```

## configs/sam9x60_sdr_sip_ebnf_linux_image_dt_defconfig
```kconfig
# Copyright (C) 2006 Microchip Technology Inc. and its subsidiaries
#
# SPDX-License-Identifier: MIT

CONFIG_SAM9X60=y
CONFIG_NANDFLASH=y
CONFIG_LOAD_LINUX=y
CONFIG_IMAGE_NAME="zImage"
# CONFIG_PMECC_AUTO_DETECT is not set
CONFIG_PMECC_CORRECT_BITS_8=y
CONFIG_IMG_SIZE="0x000c0000"
CONFIG_DEBUG=y
CONFIG_THUMB=y
CONFIG_CRYSTAL_24_000MHZ=y
CONFIG_SDRAM=y
CONFIG_BOARD_QUIRK_SAM9X60_EB=y
CONFIG_LED_ON_BOARD=y
CONFIG_LED_R_ON_PIOB=y
CONFIG_LED_R_PIN=11
CONFIG_LED_G_ON_PIOB=y
CONFIG_LED_G_PIN=12
CONFIG_LED_B_ON_PIOB=y
CONFIG_LED_B_PIN=13
```

## configs/sam9x60_sdr_sip_ebsd_linux_image_dt_defconfig
```kconfig
CONFIG_SAM9X60=y
CONFIG_RAM_8MB=y
CONFIG_SDRAM_16BIT=y
CONFIG_SDCARD=y
CONFIG_LOAD_LINUX=y
CONFIG_IMAGE_NAME="zImage"
CONFIG_DEBUG=y
CONFIG_THUMB=y
CONFIG_CRYSTAL_24_000MHZ=y
CONFIG_SDRAM=y
```

## configs/sam9x60_sdr_sip_ebsd_uboot_defconfig
```kconfig
CONFIG_SAM9X60=y
CONFIG_RAM_8MB=y
CONFIG_SDRAM_16BIT=y
CONFIG_SDCARD=y
CONFIG_DEBUG=y
CONFIG_THUMB=y
CONFIG_CRYSTAL_24_000MHZ=y
CONFIG_SDRAM=y
CONFIG_BOARD_QUIRK_SAM9X60=y
CONFIG_LED_ON_BOARD=y
CONFIG_LED_R_ON_PIOB=y
CONFIG_LED_R_PIN=11
CONFIG_LED_G_ON_PIOB=y
CONFIG_LED_G_PIN=12
CONFIG_LED_B_ON_PIOB=y
CONFIG_LED_B_PIN=13
```

## configs/sam9x60ek_bkptnone_defconfig
```kconfig
CONFIG_INIT_AND_STOP=y
CONFIG_SAM9X60=y
CONFIG_RAM_256MB=y
CONFIG_DEBUG=y
CONFIG_CRYSTAL_24_000MHZ=y
CONFIG_DDRC=y
CONFIG_DDR_SET_BY_DEVICE=y
CONFIG_DDR_W972GG6KB_9X60=y
```

## configs/sam9x60ekdf_qspi_uboot_defconfig
```kconfig
CONFIG_SAM9X60=y
CONFIG_RAM_256MB=y
CONFIG_SPI_CLK=50000000
CONFIG_QSPI=y
CONFIG_QSPI_BUS=0
CONFIG_QSPI_IOSET=1
CONFIG_IMG_ADDRESS="0x00040000"
CONFIG_IMG_SIZE="0x000c0000"
CONFIG_DEBUG=y
CONFIG_CRYSTAL_24_000MHZ=y
CONFIG_DDRC=y
CONFIG_DDR_SET_BY_DEVICE=y
CONFIG_DDR_W972GG6KB_9X60=y
CONFIG_LOAD_HW_INFO=y
CONFIG_LOAD_EEPROM=y
CONFIG_EEPROM_ADDR=0x53
CONFIG_DEFAULT_HW_INFO=5
```

## configs/sam9x60eksd_uboot_defconfig
```kconfig
CONFIG_SAM9X60=y
CONFIG_RAM_256MB=y
CONFIG_SDCARD=y
CONFIG_DEBUG=y
CONFIG_THUMB=y
CONFIG_CRYSTAL_24_000MHZ=y
CONFIG_DDRC=y
CONFIG_DDR_SET_BY_DEVICE=y
CONFIG_DDR_W972GG6KB_9X60=y
CONFIG_LOAD_HW_INFO=y
CONFIG_LOAD_EEPROM=y
CONFIG_EEPROM_ADDR=0x53
CONFIG_DEFAULT_HW_INFO=5
```

## configs/sam9x75_curiositysd_uboot_defconfig
```kconfig
# Copyright (C) 2023 Microchip Technology Inc. and its subsidiaries
#
# SPDX-License-Identifier: MIT

CONFIG_SAM9X7=y
CONFIG_DEBUG=y
CONFIG_DDR_SET_BY_DEVICE=y
CONFIG_DDR_W632GU6NB12I=y
CONFIG_SDCARD=y
CONFIG_BOARD_QUIRK_SAM9X75_CURIOSITY=y
CONFIG_LED_ON_BOARD=y
CONFIG_LED_R_ON_PIOC=y
CONFIG_LED_R_PIN=19
CONFIG_LED_G_ON_PIOC=y
CONFIG_LED_G_PIN=21
CONFIG_LED_B_ON_PIOC=y
CONFIG_LED_B_PIN=20
```

## configs/sam9x75_som1g_nf_uboot_defconfig
```kconfig
# Copyright (C) 2025 Microchip Technology Inc. and its subsidiaries
#
# SPDX-License-Identifier: MIT

CONFIG_SAM9X7=y
CONFIG_DEBUG=y
CONFIG_DDR_SET_BY_DEVICE=y
CONFIG_DDR_W631GU6NB12I=y
CONFIG_NANDFLASH=y
CONFIG_NAND_TIMING_MODE=y
CONFIG_NAND_DMA_SUPPORT=y
CONFIG_IMG_SIZE="0x00100000"
```

## configs/sam9x75_som2g_sd_uboot_defconfig
```kconfig
# Copyright (C) 2025 Microchip Technology Inc. and its subsidiaries
#
# SPDX-License-Identifier: MIT

CONFIG_SAM9X7=y
CONFIG_DEBUG=y
CONFIG_DDR_SET_BY_DEVICE=y
CONFIG_DDR_W632GU6NB12I=y
CONFIG_SDCARD=y
```

## configs/sam9x75_som512m_sd_uboot_defconfig
```kconfig
# Copyright (C) 2025 Microchip Technology Inc. and its subsidiaries
#
# SPDX-License-Identifier: MIT

CONFIG_SAM9X7=y
CONFIG_DEBUG=y
CONFIG_DDR_SET_BY_DEVICE=y
CONFIG_DDR_W9751G6NB=y
CONFIG_SDCARD=y
```

## configs/sam9x75ebsd_uboot_defconfig
```kconfig
# Copyright (C) 2022 Microchip Technology Inc. and its subsidiaries
#
# SPDX-License-Identifier: MIT
CONFIG_SAM9X7=y
CONFIG_SDCARD=y
CONFIG_SDHC0=y
CONFIG_DEBUG=y
CONFIG_THUMB=y
CONFIG_CRYSTAL_24_000MHZ=y
CONFIG_DDRC=y
CONFIG_DDR_SET_BY_DEVICE=y
CONFIG_DDR_MT41K128M16=y
CONFIG_LOAD_HW_INFO=y
CONFIG_LOAD_EEPROM=y
CONFIG_EEPROM_ADDR=0x50
CONFIG_FLEXCOM10=y
CONFIG_FLEXCOM10_IOSET=1
CONFIG_MCP16502=y
CONFIG_MCP16502_SET_VOLTAGE=y
CONFIG_PMIC_ON_TWI=0
CONFIG_VOLTAGE_LDO2=1800
CONFIG_VOLTAGE_OUT4=1200
CONFIG_BOARD_QUIRK_SAM9X75_EB=y
CONFIG_LED_ON_BOARD=y
CONFIG_LED_R_ON_PIOC=y
CONFIG_LED_R_PIN=19
CONFIG_LED_G_ON_PIOC=y
CONFIG_LED_G_PIN=21
CONFIG_LED_B_ON_PIOC=y
CONFIG_LED_B_PIN=20
```

## configs/sam9x7ebnf_uboot_defconfig
```kconfig
# Copyright (C) 2006 Microchip Technology Inc. and its subsidiaries
#
# SPDX-License-Identifier: MIT

CONFIG_SAM9X7=y
CONFIG_NANDFLASH=y
# CONFIG_PMECC_AUTO_DETECT is not set
CONFIG_PMECC_CORRECT_BITS_4=y
CONFIG_IMG_SIZE="0x000c0000"
CONFIG_DEBUG=y
CONFIG_THUMB=y
CONFIG_CRYSTAL_24_000MHZ=y
CONFIG_DDRC=y
CONFIG_DDR_SET_BY_DEVICE=y
CONFIG_DDR_MT41K128M16_9X7=y
CONFIG_LOAD_HW_INFO=y
CONFIG_LOAD_EEPROM=y
CONFIG_EEPROM_ADDR=0x50
CONFIG_BOARD_QUIRK_SAM9X7_EB=y
CONFIG_LED_ON_BOARD=y
CONFIG_LED_R_ON_PIOC=y
CONFIG_LED_R_PIN=19
CONFIG_LED_G_ON_PIOC=y
CONFIG_LED_G_PIN=21
CONFIG_LED_B_ON_PIOC=y
CONFIG_LED_B_PIN=20
```

## configs/sam9x7ebsd1_uboot_defconfig
```kconfig
# Copyright (C) 2006 Microchip Technology Inc. and its subsidiaries
#
# SPDX-License-Identifier: MIT
CONFIG_SAM9X7=y
CONFIG_SDCARD=y
CONFIG_SDHC1=y
CONFIG_DEBUG=y
CONFIG_THUMB=y
CONFIG_CRYSTAL_24_000MHZ=y
CONFIG_DDRC=y
CONFIG_DDR_SET_BY_DEVICE=y
CONFIG_DDR_MT41K128M16_9X7=y
CONFIG_LOAD_HW_INFO=y
CONFIG_LOAD_EEPROM=y
CONFIG_EEPROM_ADDR=0x50
CONFIG_BOARD_QUIRK_SAM9X7_EB=y
CONFIG_LED_ON_BOARD=y
CONFIG_LED_R_ON_PIOC=y
CONFIG_LED_R_PIN=19
CONFIG_LED_G_ON_PIOC=y
CONFIG_LED_G_PIN=21
CONFIG_LED_B_ON_PIOC=y
CONFIG_LED_B_PIN=20
```

## configs/sama5d27_som1_bkptnone_defconfig
```kconfig
CONFIG_INIT_AND_STOP=y
CONFIG_SAMA5D2=y
CONFIG_CRYSTAL_24_000MHZ=y
CONFIG_DEBUG=y
CONFIG_DDR_SET_BY_DEVICE=y
CONFIG_DDR_W971GG6SB_D2=y
CONFIG_QSPI=y
# CONFIG_ENTER_NWD is not set
```

## configs/sama5d27_som1_ekqspi_uboot_defconfig
```kconfig
# Copyright (C) 2006 Microchip Technology Inc. and its subsidiaries
#
# SPDX-License-Identifier: MIT

CONFIG_SAMA5D2=y
CONFIG_CRYSTAL_24_000MHZ=y
CONFIG_DEBUG=y
CONFIG_DDR_SET_BY_DEVICE=y
CONFIG_DDR_W971GG6SB_D2=y
CONFIG_SPI_CLK=66000000
CONFIG_QSPI=y
CONFIG_QSPI_BUS=1
CONFIG_QSPI_IOSET=2
CONFIG_IMG_ADDRESS="0x00040000"
CONFIG_JUMP_ADDR="0x23f00000"
# CONFIG_ENTER_NWD is not set
CONFIG_BOARD_QUIRK_SAMA5D2_SIP=y
CONFIG_LED_ON_BOARD=y
CONFIG_LED_R_ON_PIOA=y
CONFIG_LED_R_PIN=10
CONFIG_LED_G_ON_PIOB=y
CONFIG_LED_G_PIN=1
CONFIG_LED_B_ON_PIOA=y
CONFIG_LED_B_PIN=31
```

## configs/sama5d27_som1_eksd_uboot_defconfig
```kconfig
CONFIG_SAMA5D2=y
CONFIG_CRYSTAL_24_000MHZ=y
CONFIG_DEBUG=y
CONFIG_RAM_128MB=y
CONFIG_DDR_SET_BY_DEVICE=y
CONFIG_DDR_W971GG6SB_D2=y
CONFIG_SDCARD=y
CONFIG_JUMP_ADDR="0x23f00000"
# CONFIG_ENTER_NWD is not set
```
