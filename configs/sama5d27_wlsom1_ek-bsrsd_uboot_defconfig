## configs/sama5d27_wlsom1_ek-bsrsd_uboot_defconfig
```kconfig
CONFIG_SAMA5D2=y
CONFIG_CRYSTAL_24_000MHZ=y
CONFIG_CONSOLE_INDEX=0
CONFIG_RAM_256MB=y
CONFIG_DDR_SET_BY_DEVICE=y
CONFIG_DDR_AD220032D=y
CONFIG_SDCARD=y
CONFIG_DEBUG=y
# CONFIG_ENTER_NWD is not set
CONFIG_BACKUP_MODE=y
```

## configs/sama5d27_wlsom1_ek-opteesd_uboot_defconfig
```kconfig
# Copyright (C) 2024 Microchip Technology Inc. and its subsidiaries
#
# SPDX-License-Identifier: MIT

CONFIG_CRYSTAL_24_000MHZ=y
CONFIG_CONSOLE_INDEX=0
CONFIG_DEBUG=y
CONFIG_DDR_SET_BY_DEVICE=y
CONFIG_DDR_AD220032D=y
CONFIG_SDCARD=y
# CONFIG_SDHC_8BIT_SUPPORT is not set
CONFIG_LOAD_OPTEE=y
CONFIG_LED_ON_BOARD=y
CONFIG_LED_R_ON_PIOA=y
CONFIG_LED_R_PIN=6
CONFIG_LED_G_ON_PIOA=y
CONFIG_LED_G_PIN=7
CONFIG_LED_B_ON_PIOA=y
CONFIG_LED_B_PIN=8
```

## configs/sama5d27_wlsom1_ek_bkptnone_defconfig
```kconfig
# Copyright (C) 2006 Microchip Technology Inc. and its subsidiaries
#
# SPDX-License-Identifier: MIT

CONFIG_INIT_AND_STOP=y
CONFIG_SAMA5D2=y
CONFIG_CRYSTAL_24_000MHZ=y
CONFIG_CONSOLE_INDEX=0
CONFIG_DDR_SET_BY_DEVICE=y
CONFIG_DDR_AD220032D=y
CONFIG_SDCARD=y
CONFIG_DEBUG=y
# CONFIG_ENTER_NWD is not set
CONFIG_LED_ON_BOARD=y
CONFIG_LED_R_ON_PIOA=y
CONFIG_LED_R_PIN=6
CONFIG_LED_G_ON_PIOA=y
CONFIG_LED_G_PIN=7
CONFIG_LED_B_ON_PIOA=y
CONFIG_LED_B_PIN=8
```

## configs/sama5d27_wlsom1_ekdf_qspi_uboot_defconfig
```kconfig
# Copyright (C) 2006 Microchip Technology Inc. and its subsidiaries
#
# SPDX-License-Identifier: MIT

CONFIG_SAMA5D2=y
CONFIG_CRYSTAL_24_000MHZ=y
CONFIG_CONSOLE_INDEX=0
CONFIG_DDR_SET_BY_DEVICE=y
CONFIG_DDR_AD220032D=y
CONFIG_SPI_CLK=50000000
CONFIG_QSPI=y
CONFIG_QSPI_BUS=1
CONFIG_QSPI_IOSET=2
CONFIG_IMG_ADDRESS="0x00040000"
CONFIG_IMG_SIZE="0x000c0000"
CONFIG_DEBUG=y
# CONFIG_ENTER_NWD is not set
CONFIG_LED_ON_BOARD=y
CONFIG_LED_R_ON_PIOA=y
CONFIG_LED_R_PIN=6
CONFIG_LED_G_ON_PIOA=y
CONFIG_LED_G_PIN=7
CONFIG_LED_B_ON_PIOA=y
CONFIG_LED_B_PIN=8
```

## configs/sama5d29_curiosity_bkptnone_defconfig
```kconfig
# Copyright (C) 2023 Microchip Technology Inc. and its subsidiaries
#
# SPDX-License-Identifier: MIT

CONFIG_INIT_AND_STOP=y
CONFIG_CRYSTAL_24_000MHZ=y
CONFIG_CONSOLE_INDEX=0
CONFIG_DEBUG=y
CONFIG_DDR_SET_BY_DEVICE=y
CONFIG_DDR_AS4C128M32MD2A=y
CONFIG_LED_ON_BOARD=y
CONFIG_LED_R_ON_PIOA=y
CONFIG_LED_R_PIN=7
CONFIG_LED_G_ON_PIOA=y
CONFIG_LED_G_PIN=8
CONFIG_LED_B_ON_PIOA=y
CONFIG_LED_B_PIN=9
```

## configs/sama5d29_curiositydf_qspi_uboot_defconfig
```kconfig
# Copyright (C) 2023 Microchip Technology Inc. and its subsidiaries
#
# SPDX-License-Identifier: MIT

CONFIG_CRYSTAL_24_000MHZ=y
CONFIG_CONSOLE_INDEX=0
CONFIG_DEBUG=y
CONFIG_DDR_SET_BY_DEVICE=y
CONFIG_DDR_AS4C128M32MD2A=y
CONFIG_SPI_CLK=50000000
CONFIG_QSPI=y
CONFIG_QSPI_BUS=1
CONFIG_QSPI_IOSET=2
CONFIG_IMG_ADDRESS="0x00040000"
CONFIG_IMG_SIZE="0x00100000"
CONFIG_LED_ON_BOARD=y
CONFIG_LED_R_ON_PIOA=y
CONFIG_LED_R_PIN=7
CONFIG_LED_G_ON_PIOA=y
CONFIG_LED_G_PIN=8
CONFIG_LED_B_ON_PIOA=y
CONFIG_LED_B_PIN=9
```

## configs/sama5d29_curiositysd_fb_uboot_defconfig
```kconfig
# Copyright (C) 2023 Microchip Technology Inc. and its subsidiaries
#
# SPDX-License-Identifier: MIT

CONFIG_CRYSTAL_24_000MHZ=y
CONFIG_CONSOLE_INDEX=0
CONFIG_DEBUG=y
CONFIG_DDR_SET_BY_DEVICE=y
CONFIG_DDR_AS4C128M32MD2A=y
CONFIG_SDCARD=y
CONFIG_BACKUP_MODE=y
CONFIG_FAST_BOOT=y
CONFIG_FASTBOOT_MEM_MAP_ADDRESS=0xC0000000
CONFIG_FASTBOOT_MAX_NB_MEM_MAP=0x20000
CONFIG_FASTBOOT_SIZEOF_PAGE_STRU=0x24
CONFIG_FASTBOOT_OFFSET_OF_PAGETYPE=0x18
CONFIG_FASTBOOT_OFFSET_OF_PRIVATE=0x14
CONFIG_FASTBOOT_SD_PARTITION=3
CONFIG_LED_ON_BOARD=y
CONFIG_LED_R_ON_PIOA=y
CONFIG_LED_R_PIN=7
CONFIG_LED_G_ON_PIOA=y
CONFIG_LED_G_PIN=8
CONFIG_LED_B_ON_PIOA=y
CONFIG_LED_B_PIN=9
```

## configs/sama5d2_icp-bsrsd_uboot_defconfig
```kconfig
# Copyright (C) 2006 Microchip Technology Inc. and its subsidiaries
#
# SPDX-License-Identifier: MIT

CONFIG_SAMA5D2=y
CONFIG_CRYSTAL_12_000MHZ=y
CONFIG_BUS_SPEED_166MHZ=y
CONFIG_MCK_BYPASS=y
CONFIG_CONSOLE_INDEX=0
CONFIG_DDR_SET_BY_DEVICE=y
CONFIG_DDR_W632GU6MB=y
CONFIG_SDCARD=y
CONFIG_DEBUG=y
# CONFIG_ENTER_NWD is not set
# CONFIG_SDHC_8BIT_SUPPORT is not set
CONFIG_TWI1=y
CONFIG_TWI1_IOSET=3
CONFIG_FLEXCOM4=y
CONFIG_FLEXCOM4_IOSET=1
CONFIG_MCP16502=y
CONFIG_PMIC_ON_TWI=1
CONFIG_MCP16502_SET_VOLTAGE=y
CONFIG_VOLTAGE_LDO2=3300
CONFIG_BACKUP_MODE=y
CONFIG_BOARD_QUIRK_SAMA5D2_ICP=y
CONFIG_LED_ON_BOARD=y
CONFIG_LED_R_ON_PIOB=y
CONFIG_LED_R_PIN=0
CONFIG_LED_G_ON_PIOB=y
CONFIG_LED_G_PIN=1
CONFIG_LED_B_ON_PIOA=y
CONFIG_LED_B_PIN=31
```

## configs/sama5d2_icpdf_qspi_uboot_defconfig
```kconfig
CONFIG_SAMA5D2=y
CONFIG_CRYSTAL_12_000MHZ=y
CONFIG_BUS_SPEED_166MHZ=y
CONFIG_MCK_BYPASS=y
CONFIG_CONSOLE_INDEX=0
CONFIG_DDR_SET_BY_DEVICE=y
CONFIG_DDR_W632GU6MB=y
CONFIG_QSPI=y
CONFIG_QSPI_BUS=1
CONFIG_IMG_ADDRESS="0x00040000"
CONFIG_DEBUG=y
# CONFIG_ENTER_NWD is not set
CONFIG_TWI1=y
CONFIG_TWI1_IOSET=3
```

## configs/sama5d2_ptc_ek_bkptnone_defconfig
```kconfig
# Copyright (C) 2006 Microchip Technology Inc. and its subsidiaries
#
# SPDX-License-Identifier: MIT

CONFIG_INIT_AND_STOP=y
CONFIG_SAMA5D2=y
CONFIG_CRYSTAL_24_000MHZ=y
CONFIG_DEBUG=y
CONFIG_CONSOLE_INDEX=0
CONFIG_DDR_SET_BY_DEVICE=y
CONFIG_DDR_W972GG6KB_D2=y
# CONFIG_ENTER_NWD is not set
```

## configs/sama5d2_ptc_ekdf_qspi_uboot_defconfig
```kconfig
# Copyright (C) 2006 Microchip Technology Inc. and its subsidiaries
#
# SPDX-License-Identifier: MIT

CONFIG_SAMA5D2=y
CONFIG_CRYSTAL_24_000MHZ=y
CONFIG_DEBUG=y
CONFIG_CONSOLE_INDEX=0
CONFIG_DDR_SET_BY_DEVICE=y
CONFIG_DDR_W972GG6KB_D2=y
CONFIG_QSPI=y
CONFIG_QSPI_BUS=0
CONFIG_QSPI_IOSET=3
CONFIG_QSPI_4B_OPCODES=y
# CONFIG_ENTER_NWD is not set
```

## configs/sama5d2_ptc_eksd1_uboot_defconfig
```kconfig
# Copyright (C) 2006 Microchip Technology Inc. and its subsidiaries
#
# SPDX-License-Identifier: MIT

CONFIG_SAMA5D2=y
CONFIG_CRYSTAL_24_000MHZ=y
CONFIG_DEBUG=y
CONFIG_CONSOLE_INDEX=0
CONFIG_DDR_SET_BY_DEVICE=y
CONFIG_DDR_W972GG6KB_D2=y
CONFIG_SDCARD=y
CONFIG_SDHC1=y
# CONFIG_ENTER_NWD is not set
```

## configs/sama5d2_xplained-bsrdf_uboot_defconfig
```kconfig
CONFIG_SAMA5D2=y
CONFIG_CRYSTAL_12_000MHZ=y
CONFIG_BUS_SPEED_166MHZ=y
CONFIG_DEBUG=y
CONFIG_DDR_SET_BY_DEVICE=y
CONFIG_DDR_MT41K128M16_D2=y
CONFIG_SPI=y
CONFIG_SPI_BUS=0
CONFIG_SPI_IOSET=1
# CONFIG_ENTER_NWD is not set
CONFIG_BACKUP_MODE=y
CONFIG_ACT8865_SET_VOLTAGE=y
# CONFIG_DISABLE_ACT8865_I2C is not set
CONFIG_SUSPEND_ACT8945A_CHARGER=y
```

## configs/sama5d2_xplained-bsrsd_uboot_defconfig
```kconfig
CONFIG_SAMA5D2=y
CONFIG_CRYSTAL_12_000MHZ=y
CONFIG_BUS_SPEED_166MHZ=y
CONFIG_DEBUG=y
CONFIG_RAM_512MB=y
CONFIG_DDR_SET_BY_DEVICE=y
CONFIG_DDR_MT41K128M16_D2=y
CONFIG_SDCARD=y
CONFIG_SDHC1=y
# CONFIG_ENTER_NWD is not set
CONFIG_BACKUP_MODE=y
CONFIG_TWI0=y
CONFIG_TWI1=y
CONFIG_ACT8865=y
CONFIG_ACT8865_SET_VOLTAGE=y
CONFIG_VOLTAGE_OUT2=1200
CONFIG_VOLTAGE_OUT4=2500
CONFIG_VOLTAGE_OUT5=3300
CONFIG_VOLTAGE_OUT6=2500
CONFIG_VOLTAGE_OUT7=1800
# CONFIG_DISABLE_ACT8865_I2C is not set
CONFIG_SUSPEND_ACT8945A_CHARGER=y
```

## configs/sama5d2_xplained_bkptnone_defconfig
```kconfig
CONFIG_INIT_AND_STOP=y
CONFIG_SAMA5D2=y
CONFIG_CRYSTAL_12_000MHZ=y
CONFIG_BUS_SPEED_166MHZ=y
CONFIG_DEBUG=y
CONFIG_DDR_SET_BY_DEVICE=y
CONFIG_DDR_MT41K128M16_D2=y
# CONFIG_ENTER_NWD is not set
CONFIG_TWI0=y
CONFIG_TWI0_IOSET=4
CONFIG_TWI1=y
CONFIG_TWI1_IOSET=2
CONFIG_ACT8865=y
CONFIG_ACT8865_SET_VOLTAGE=y
CONFIG_VOLTAGE_OUT2=1200
CONFIG_VOLTAGE_OUT4=2500
CONFIG_VOLTAGE_OUT5=3300
CONFIG_VOLTAGE_OUT6=2500
CONFIG_VOLTAGE_OUT7=1800
# CONFIG_DISABLE_ACT8865_I2C is not set
CONFIG_SUSPEND_ACT8945A_CHARGER=y
CONFIG_LOAD_HW_INFO=y
CONFIG_LOAD_EEPROM=y
CONFIG_EEPROM_ON_TWI=1
CONFIG_EEPROM_ADDR=0x54
CONFIG_EEPROM_SIZE=256
CONFIG_BOARD_QUIRK_SAMA5D2_XULT=y
```

## configs/sama5d2_xplaineddf_qspi_uboot_defconfig
```kconfig
CONFIG_SAMA5D2=y
CONFIG_CRYSTAL_12_000MHZ=y
CONFIG_DDR_SET_BY_DEVICE=y
CONFIG_DDR_MT41K128M16_D2=y
CONFIG_QSPI=y
CONFIG_QSPI_BUS=0
CONFIG_QSPI_IOSET=3
CONFIG_QSPI_4B_OPCODES=y
CONFIG_IMG_ADDRESS="0x00040000"
CONFIG_DEBUG=y
# CONFIG_ENTER_NWD is not set
CONFIG_ACT8865_SET_VOLTAGE=y
# CONFIG_DISABLE_ACT8865_I2C is not set
CONFIG_SUSPEND_ACT8945A_CHARGER=y
```

## configs/sama5d2_xplainedemmc_uboot_defconfig
```kconfig
# Copyright (C) 2006 Microchip Technology Inc. and its subsidiaries
#
# SPDX-License-Identifier: MIT

CONFIG_SAMA5D2=y
CONFIG_CRYSTAL_12_000MHZ=y
CONFIG_BUS_SPEED_166MHZ=y
CONFIG_DEBUG=y
CONFIG_DDR_SET_BY_DEVICE=y
CONFIG_DDR_MT41K128M16_D2=y
CONFIG_SDCARD=y
# CONFIG_ENTER_NWD is not set
CONFIG_TWI0=y
CONFIG_TWI0_IOSET=4
CONFIG_TWI1=y
CONFIG_TWI1_IOSET=2
CONFIG_ACT8865=y
CONFIG_ACT8865_SET_VOLTAGE=y
CONFIG_ACT8865_VSEL=1
CONFIG_VOLTAGE_OUT2=1250
CONFIG_VOLTAGE_OUT4=2500
CONFIG_VOLTAGE_OUT5=3300
CONFIG_VOLTAGE_OUT6=3300
CONFIG_VOLTAGE_OUT7=1800
# CONFIG_DISABLE_ACT8865_I2C is not set
CONFIG_SUSPEND_ACT8945A_CHARGER=y
CONFIG_LOAD_HW_INFO=y
CONFIG_LOAD_EEPROM=y
CONFIG_EEPROM_ON_TWI=1
CONFIG_EEPROM_ADDR=0x54
CONFIG_EEPROM_SIZE=256
CONFIG_BOARD_QUIRK_SAMA5D2_XULT=y
CONFIG_LED_ON_BOARD=y
CONFIG_LED_R_ON_PIOB=y
CONFIG_LED_R_PIN=6
CONFIG_LED_R_VALUE=1
CONFIG_LED_G_ON_PIOB=y
CONFIG_LED_G_PIN=5
CONFIG_LED_G_VALUE=0
CONFIG_LED_B_ON_PIOB=y
CONFIG_LED_B_PIN=0
CONFIG_LED_B_VALUE=1
```

## configs/sama5d3_xplained_bkptnone_defconfig
```kconfig
# Copyright (C) 2006 Microchip Technology Inc. and its subsidiaries
#
# SPDX-License-Identifier: MIT

CONFIG_INIT_AND_STOP=y
CONFIG_SAMA5D3X=y
CONFIG_CRYSTAL_12_000MHZ=y
CONFIG_CPU_CLK_528MHZ=y
CONFIG_DDR_SET_BY_DEVICE=y
CONFIG_DDR_MT47H64M16=y
CONFIG_NOT_DQS_DISABLED=y
CONFIG_DEBUG=y
CONFIG_TWI1=y
CONFIG_ACT8865=y
CONFIG_ACT8865_SET_VOLTAGE=y
CONFIG_VOLTAGE_OUT2=1250
CONFIG_VOLTAGE_OUT5=3300
CONFIG_LED_ON_BOARD=y
CONFIG_LED_R_ON_PIOE=y
CONFIG_LED_R_PIN=24
CONFIG_LED_R_VALUE=1
CONFIG_LED_B_ON_PIOE=y
CONFIG_LED_B_PIN=23
CONFIG_LED_B_VALUE=0
```

## configs/sama5d3_xplainednf_uboot_defconfig
```kconfig
# Copyright (C) 2006 Microchip Technology Inc. and its subsidiaries
#
# SPDX-License-Identifier: MIT

CONFIG_SAMA5D3X=y
CONFIG_CRYSTAL_12_000MHZ=y
CONFIG_CPU_CLK_528MHZ=y
CONFIG_DDR_SET_BY_DEVICE=y
CONFIG_DDR_MT47H64M16=y
CONFIG_NOT_DQS_DISABLED=y
CONFIG_NANDFLASH=y
CONFIG_MMU=y
CONFIG_CACHES=y
# CONFIG_PMECC_AUTO_DETECT is not set
CONFIG_PMECC_CORRECT_BITS_4=y
CONFIG_IMG_SIZE="0x000c0000"
CONFIG_DEBUG=y
CONFIG_TWI1=y
CONFIG_ACT8865=y
CONFIG_ACT8865_SET_VOLTAGE=y
CONFIG_VOLTAGE_OUT2=1250
CONFIG_VOLTAGE_OUT5=3300
CONFIG_LED_ON_BOARD=y
CONFIG_LED_R_ON_PIOE=y
CONFIG_LED_R_PIN=24
CONFIG_LED_R_VALUE=1
CONFIG_LED_B_ON_PIOE=y
CONFIG_LED_B_PIN=23
CONFIG_LED_B_VALUE=0
```

## configs/sama5d3_xplainedsd_uboot_defconfig
```kconfig
CONFIG_SAMA5D3X=y
CONFIG_CRYSTAL_12_000MHZ=y
CONFIG_DDR_SET_BY_DEVICE=y
CONFIG_DDR_MT47H64M16=y
CONFIG_NOT_DQS_DISABLED=y
CONFIG_SDCARD=y
CONFIG_DEBUG=y
CONFIG_SCLK=y
CONFIG_PM_EXTERNAL_DEVICES=y
CONFIG_MAC0_PHY=y
CONFIG_MAC1_PHY=y
CONFIG_TWI1=y
CONFIG_ACT8865=y
CONFIG_ACT8865_SET_VOLTAGE=y
CONFIG_VOLTAGE_OUT2=1250
CONFIG_VOLTAGE_OUT5=3300
```

## configs/sama5d3xekdf_uboot_defconfig
```kconfig
# Copyright (C) 2006 Microchip Technology Inc. and its subsidiaries
#
# SPDX-License-Identifier: MIT

CONFIG_SAMA5D3X=y
CONFIG_CRYSTAL_12_000MHZ=y
CONFIG_CPU_CLK_528MHZ=y
CONFIG_DDR_SET_BY_DEVICE=y
CONFIG_DDR_MT47H128M16=y
CONFIG_NOT_DQS_DISABLED=y
CONFIG_DEBUG=y
CONFIG_SCLK=y
CONFIG_LOAD_HW_INFO=y
CONFIG_LOAD_ONE_WIRE=y
CONFIG_ONE_WIRE_ON_PIOE=y
CONFIG_ONE_WIRE_PIN=25
CONFIG_BOARD_QUIRK_SAMA5D3=y
```

## configs/sama5d3xeksd_uboot_defconfig
```kconfig
CONFIG_SAMA5D3X=y
CONFIG_CRYSTAL_12_000MHZ=y
CONFIG_DDR_SET_BY_DEVICE=y
CONFIG_DDR_MT47H128M16=y
CONFIG_SDCARD=y
CONFIG_DEBUG=y
CONFIG_SCLK=y
CONFIG_LOAD_ONE_WIRE=y
```

## configs/sama5d4_xplainedsd_uboot_secure_defconfig
```kconfig
# Copyright (C) 2006 Microchip Technology Inc. and its subsidiaries
#
# SPDX-License-Identifier: MIT

CONFIG_SAMA5D4=y
CONFIG_CRYSTAL_12_000MHZ=y
CONFIG_CPU_CLK_600MHZ=y
CONFIG_DDR_SET_BY_DEVICE=y
CONFIG_DDR_MT47H128M16=y
CONFIG_DDR_EXT_TEMP_RANGE=y
CONFIG_SDCARD=y
CONFIG_DEBUG=y
CONFIG_SCLK=y
# CONFIG_ENTER_NWD is not set
CONFIG_PM_EXTERNAL_DEVICES=y
CONFIG_MAC0_PHY=y
CONFIG_HDMI=y
CONFIG_TWI0=y
CONFIG_TWI3=y
CONFIG_ACT8865=y
CONFIG_ACT8865_SET_VOLTAGE=y
CONFIG_VOLTAGE_OUT5=3300
CONFIG_VOLTAGE_OUT6=1800
CONFIG_PMIC_ON_TWI=1
CONFIG_LOAD_HW_INFO=y
CONFIG_LOAD_EEPROM=y
CONFIG_EEPROM_ADDR=0x54
CONFIG_EEPROM_SIZE=256
CONFIG_BOARD_QUIRK_SAMA5D4=y
CONFIG_AT91_MCI1=y
```

## configs/sama5d4eknf_uboot_secure_defconfig
```kconfig
# Copyright (C) 2006 Microchip Technology Inc. and its subsidiaries
#
# SPDX-License-Identifier: MIT

CONFIG_SAMA5D4=y
CONFIG_CRYSTAL_12_000MHZ=y
CONFIG_CPU_CLK_528MHZ=y
CONFIG_BUS_SPEED_176MHZ=y
CONFIG_DDR_SET_BY_DEVICE=y
CONFIG_DDR_MT47H128M8=y
CONFIG_NANDFLASH=y
# CONFIG_USE_ON_DIE_ECC_SUPPORT is not set
CONFIG_DEBUG=y
CONFIG_SCLK=y
# CONFIG_ENTER_NWD is not set
CONFIG_PM_EXTERNAL_DEVICES=y
CONFIG_MAC0_PHY=y
CONFIG_MAC1_PHY=y
CONFIG_HDMI=y
CONFIG_WM8904=y
CONFIG_TWI0=y
CONFIG_TWI3=y
CONFIG_ACT8865=y
CONFIG_ACT8865_SET_VOLTAGE=y
CONFIG_VOLTAGE_OUT5=3300
CONFIG_VOLTAGE_OUT6=1800
CONFIG_LOAD_HW_INFO=y
CONFIG_LOAD_ONE_WIRE=y
CONFIG_ONE_WIRE_ON_PIOE=y
CONFIG_ONE_WIRE_PIN=28
CONFIG_BOARD_QUIRK_SAMA5D4=y
```

## configs/sama5d4eksd_uboot_secure_defconfig
```kconfig
# Copyright (C) 2006 Microchip Technology Inc. and its subsidiaries
#
# SPDX-License-Identifier: MIT

CONFIG_SAMA5D4=y
CONFIG_CRYSTAL_12_000MHZ=y
CONFIG_CPU_CLK_528MHZ=y
CONFIG_DDR_SET_BY_DEVICE=y
CONFIG_DDR_MT47H128M8=y
CONFIG_SDCARD=y
CONFIG_AT91_MCI1=y
CONFIG_DEBUG=y
# CONFIG_ENTER_NWD is not set
CONFIG_TWI0=y
CONFIG_TWI3=y
CONFIG_ACT8865=y
CONFIG_ACT8865_SET_VOLTAGE=y
CONFIG_VOLTAGE_OUT5=3300
CONFIG_VOLTAGE_OUT6=1800
CONFIG_LOAD_HW_INFO=y
CONFIG_LOAD_ONE_WIRE=y
CONFIG_BOARD_QUIRK_SAMA5D4=y
```
