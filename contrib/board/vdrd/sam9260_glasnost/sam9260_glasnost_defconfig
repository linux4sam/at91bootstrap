## contrib/board/vdrd/sam9260_glasnost/sam9260_glasnost_defconfig
```kconfig
CONFIG_SPI_BOOT_CS0=y
CONFIG_THUMB=y
CONFIG_IMG_SIZE="0x00080000"
CONFIG_DEBUG=y
```

## device/Config.in
```kconfig
# Copyright (C) 2006 Microchip Technology Inc. and its subsidiaries
#
# SPDX-License-Identifier: MIT

config LINK_ADDR
	string
	default "0x200000" if SAMA5D4  || SAMA5D2
	default "0x100000" if SAMA7G5
	default "0x300000"


config TOP_OF_MEMORY
	string
	default "0x310000"	if SAM9X60
	default "0x310000"	if SAMA5D3X
	default "0x210000"	if SAMA5D4
	default "0x210000"	if SAMA5D2
	default "0x120000"	if SAMA7G5
	help
	    The top address of internal SRAM

config CPU_HAS_TRUSTZONE
	bool
	default n

config CPU_HAS_TZC400
	bool
	default n

config CPU_V7
	bool
	default n

config HAS_PMIC_ACT8865
	bool
	default n

config SUPPORT_PM
	bool
	default n

config HAS_ONE_WIRE
	bool
	default n

config HAS_EEPROM
	bool
	default n

config HAS_EHT0_PHY
	bool
	default n

config HAS_EHT1_PHY
	bool
	default n

config HAS_AUDIO_CODEC
	bool
	default n

config HAS_HDMI
	bool
	default n

config CORE_ARM926EJS
	bool
	default n

config CORE_CORTEX_A5
	bool
	default n

config CORE_CORTEX_A7
	bool
	default n

config CPU_HAS_UMCTL2
	bool
	default n

config CPU_HAS_DDRC
	bool
	default n

config CPU_HAS_SDDRC
	bool
	default n

config CPU_HAS_SDRAMC
	bool
	default n

config CPU_HAS_SCKC
	bool
	default n

config CPU_HAS_H32MXDIV
	bool
	default n

config CPU_HAS_HSMCI0
	bool
	default n

config CPU_HAS_HSMCI1
	bool
	default n

config CPU_HAS_HSMCI2
	bool
	default n

config CPU_HAS_MCI0
	bool
	default n

config CPU_HAS_MCI1
	bool
	default n

config CPU_HAS_SDHC0
	bool
	default n

config CPU_HAS_SDHC1
	bool
	default n

config CPU_HAS_SDHC2
	bool
	default n

config CPU_HAS_SPI
	bool
	default n

config CPU_HAS_SPI_IOSET
	bool
	default n

config CPU_HAS_QSPI
	bool
	default n

config CPU_HAS_QSPI_IOSET
	bool
	default n

config CPU_HAS_SCLK_BYPASS
	bool
	default n
```

## device/sam9x60/Config.in
```kconfig
# Copyright (C) 2006 Microchip Technology Inc. and its subsidiaries
#
# SPDX-License-Identifier: MIT

config SPI_BUS_MAX
	int
	default 5 if SAM9X60

config SPI_IOSET_MAX
	int
	default 6 if SAM9X60

config QSPI_BUS_MAX
	int
	default 0 if SAM9X60

config QSPI_IOSET_MAX
	int
	default 1 if SAM9X60

config DEVICENAME
	string
	default "sam9x60" if SAM9X60
```

## device/sam9x60/sam9x60_sd_uboot_defconfig
```kconfig
CONFIG_SAM9X60_BOARD=y
CONFIG SAM9X60=y
CONFIG_RAM_256MB=y
CONFIG_SDCARD=y
CONFIG_DEBUG=y
CONFIG_THUMB=y
```

## device/sam9x7/Config.in
```kconfig
# Copyright (C) 2022 Microchip Technology Inc. and its subsidiaries
#
# SPDX-License-Identifier: MIT

config SPI_BUS_MAX
	int
	default 5 if SAM9X7

config SPI_IOSET_MAX
	int
	default 6 if SAM9X7

config QSPI_BUS_MAX
	int
	default 0 if SAM9X7

config QSPI_IOSET_MAX
	int
	default 1 if SAM9X7

config DEVICENAME
	string
	default "sam9x7" if SAM9X7
```

## device/sama5d2/Config.in
```kconfig
# Copyright (C) 2006 Microchip Technology Inc. and its subsidiaries
#
# SPDX-License-Identifier: MIT

config SPI_BUS_MAX
	int
	default 1 if SAMA5D2

config SPI_IOSET_MAX
	int
	default 3 if SAMA5D2

config QSPI_BUS_MAX
	int
	default 1 if SAMA5D2

config QSPI_IOSET_MAX
	int
	default 3 if SAMA5D2

config DEVICENAME
	string
	default "sama5d2" if SAMA5D2

config TWI_IOSET
	bool
	default y if SAMA5D2

config TWI_IOSET_MAX
	int
	default 4 if SAMA5D2

config FLEXCOM_TWI_IOSET
	bool
	default y if SAMA5D2

config FLEXCOM_TWI_IOSET_MAX
	int
	default 3 if SAMA5D2
```

## device/sama5d4/Config.in
```kconfig
# Copyright (C) 2006 Microchip Technology Inc. and its subsidiaries
#
# SPDX-License-Identifier: MIT

config DEVICENAME
	string
	default "sama5d4" if SAMA5D4
```

## device/sama7d65/Config.in
```kconfig
# Copyright (C) 2006 Microchip Technology Inc. and its subsidiaries
#
# SPDX-License-Identifier: MIT

config DEVICENAME
	string
	default "sama7d65" if SAMA7D65

config FLEXCOM_TWI_IOSET
	bool
	default y if SAMA7D65

config FLEXCOM_TWI_IOSET_MAX
	int
	default 5 if SAMA7D65

config QSPI_BUS_MAX
	int
	default 1 if SAMA7D65

config QSPI_IOSET_MAX
	int
	default 1 if SAMA7D65
```

## device/sama7g5/Config.in
```kconfig
# Copyright (C) 2006 Microchip Technology Inc. and its subsidiaries
#
# SPDX-License-Identifier: MIT

config DEVICENAME
	string
	default "sama7g5" if SAMA7G5

config FLEXCOM_TWI_IOSET
	bool
	default y if SAMA7G5

config FLEXCOM_TWI_IOSET_MAX
	int
	default 5 if SAMA7G5

config QSPI_BUS_MAX
	int
	default 1 if SAMA7G5

config QSPI_IOSET_MAX
	int
	default 1 if SAMA7G5
```

## host-utilities/Config.in
```kconfig
config CONFIG_SX_AT91
	bool "Build 'sx_at91' an accurate X-Modem for minicom"
	default y
	help
	  Minicom X-Modem is unreliable, this works.


config CONFIG_RAW_AT91
	bool "Build 'raw_at91' for downloading the u-boot environment via minicom"
	default y
	help
	  If you cut and paste a file to an U-Boot terminal,
	  U-Boot cannot handle this.
	  raw-at91 will send the file line by line with a long delay
	  between each line.
	  Note: do not program any flash memory or perform a
	  network transfer as part of the file.
	  The delay is not THAT long
```
